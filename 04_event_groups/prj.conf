## CMakeLists.txt
```
cmake_minimum_required(VERSION 3.20.0)

find_package(Zephyr REQUIRED HINTS $ENV{ZEPHYR_BASE})
project(event_groups)

target_sources(app PRIVATE src/main.c)
# Exactly one demo is compiled in, chosen in prj.conf (see Kconfig).
target_sources_ifdef(CONFIG_APP_DEMO_GATE     app PRIVATE src/startup_gate.c)
target_sources_ifdef(CONFIG_APP_DEMO_DISPATCH app PRIVATE src/dispatcher.c)
```

## Kconfig
```
# Application options for 04_event_groups.
# Change them in prj.conf; no code edits are needed for the experiments.

mainmenu "04_event_groups"

choice APP_DEMO
	prompt "Which demo to build"
	default APP_DEMO_GATE

config APP_DEMO_GATE
	bool "Part A: wait-all start-up gate"

config APP_DEMO_DISPATCH
	bool "Part B: wait-any dispatcher"

endchoice

config APP_REPORT_PERIOD_MS
	int "Period of the statistics report printed by main (ms)"
	default 2000

config APP_DEBOUNCE_MS
	int "Ignore button edges closer than this to the last accepted one (ms, 0 = off)"
	default 50
	help
	  The debounce that tutorial 02, experiment A5, recommended. It is
	  done in the button ISR in main.c, before the demo sees the press.

# --- Part A: used only when APP_DEMO_GATE is selected ---

config APP_SENSOR_INIT_MS
	int "Time until the sensor is ready (ms)"
	default 300

config APP_CONFIG_INIT_MS
	int "Time until the configuration is loaded (ms)"
	default 800

config APP_LINK_INIT_MS
	int "Time until the link comes up for the first time (ms)"
	default 1500

config APP_LINK_UP_TIME_MS
	int "How long the link stays up in each cycle (ms, 0 = up for ever)"
	default 3000

config APP_LINK_DOWN_TIME_MS
	int "How long the link stays down in each cycle (ms)"
	default 2000
	range 1 100000

config APP_TRANSFER_MS
	int "Duration of one transfer done by the worker (ms)"
	default 200
	range 1 10000

config APP_GATE_TIMEOUT_MS
	int "Timeout of the worker's wait for the gate (ms)"
	default 1000
	range 1 100000
	help
	  On timeout the worker prints which conditions are still missing
	  and waits again.

config APP_GATE_WAIT_ANY
	bool "Experiment A2: wait for ANY condition instead of ALL (wrong)"

config APP_GATE_RESET
	bool "Experiment A3: wait with reset = true (wrong here)"
	help
	  The reset argument clears the tracked events BEFORE the wait. It
	  is not a clear-on-exit, and it erases bits other threads posted.

config APP_LINK_USE_SET
	bool "Experiment A4: the link thread uses k_event_set() instead of k_event_post() (wrong)"
	help
	  k_event_set() replaces the whole 32-bit word, so it erases every
	  other condition.

# --- Part B: used only when APP_DEMO_DISPATCH is selected ---

config APP_TICK_PERIOD_MS
	int "Period of the timer source (ms, 0 = off)"
	default 1000

config APP_DATA_PERIOD_MS
	int "Period of the data-producer thread (ms, 0 = off)"
	default 300

config APP_HANDLE_MS
	int "Time the dispatcher spends handling one event (ms)"
	default 50
	range 1 10000

config APP_CLEAR_AFTER_HANDLING
	bool "Experiment B2: clear the bits after handling instead of before (wrong)"

config APP_BUTTON_LOGGER
	bool "Experiments B3/B4: a second thread that also waits for the button bit"

config APP_LOGGER_PRIORITY
	int "Priority of the logger thread (lower number = more urgent)"
	default 4
	range 0 14
	help
	  4 is less urgent than the dispatcher (2), which owns the clearing.
	  1 is more urgent: see experiment B4.

source "Kconfig.zephyr"
```

## prj.conf
```kconfig
# --- Kernel objects ---
# k_event is optional in Zephyr: without this, K_EVENT_DEFINE does not exist.
CONFIG_EVENTS=y

# --- Drivers ---
CONFIG_GPIO=y

# --- Scheduling ---
# main() blinks a heartbeat LED and prints reports: least urgent priority.
# Lower number = higher priority.
#   Part A: worker 3, init and link threads 5.
#   Part B: dispatcher 2, logger 4 (optional), data producer 5.
CONFIG_MAIN_THREAD_PRIORITY=7
CONFIG_THREAD_NAME=y

# --- Debugging ---
CONFIG_ASSERT=y

# --- Which demo: uncomment exactly one line ---
CONFIG_APP_DEMO_GATE=y
# CONFIG_APP_DEMO_DISPATCH=y

# --- Common options (see Kconfig) ---
CONFIG_APP_REPORT_PERIOD_MS=2000
CONFIG_APP_DEBOUNCE_MS=50

# --- Part A options ---
CONFIG_APP_SENSOR_INIT_MS=300
CONFIG_APP_CONFIG_INIT_MS=800
CONFIG_APP_LINK_INIT_MS=1500
CONFIG_APP_LINK_UP_TIME_MS=3000
CONFIG_APP_LINK_DOWN_TIME_MS=2000
CONFIG_APP_TRANSFER_MS=200
CONFIG_APP_GATE_TIMEOUT_MS=1000
# Experiments: uncomment one at a time.
# CONFIG_APP_GATE_WAIT_ANY=y
# CONFIG_APP_GATE_RESET=y
# CONFIG_APP_LINK_USE_SET=y

# --- Part B options ---
CONFIG_APP_TICK_PERIOD_MS=1000
CONFIG_APP_DATA_PERIOD_MS=300
CONFIG_APP_HANDLE_MS=50
# Experiments: uncomment as described in the README.
# CONFIG_APP_CLEAR_AFTER_HANDLING=y
# CONFIG_APP_BUTTON_LOGGER=y
CONFIG_APP_LOGGER_PRIORITY=4
```

## src/main.c
```c
/*
 * 04_event_groups: common part
 * Board: STM32F769I-DISCO, Zephyr RTOS
 *
 * This file owns the hardware: the blue USER button, the red event LED
 * (LD1) and the green heartbeat LED (LD2). It sets them up, debounces the
 * button and forwards presses to the demo, and then runs at the lowest
 * priority, blinking the heartbeat and calling demo_report().
 *
 * The event-group work is in the demo file that prj.conf selects:
 *   Part A  src/startup_gate.c  wait for ALL of several conditions
 *   Part B  src/dispatcher.c    react to ANY of several sources
 *
 * Theory: resources/webpages/07_event_groups_and_notifications.html
 */

#include <zephyr/kernel.h>
#include <zephyr/drivers/gpio.h>
#include <zephyr/sys/printk.h>

#include "demo.h"

#define HEARTBEAT_PERIOD_MS 500

static const struct gpio_dt_spec button        = GPIO_DT_SPEC_GET(DT_ALIAS(sw0), gpios);
static const struct gpio_dt_spec event_led     = GPIO_DT_SPEC_GET(DT_ALIAS(led0), gpios);
static const struct gpio_dt_spec heartbeat_led = GPIO_DT_SPEC_GET(DT_ALIAS(led1), gpios);

static struct gpio_callback button_cb;

void event_led_toggle(void)
{
	gpio_pin_toggle_dt(&event_led);
}

void event_led_set(bool on)
{
	gpio_pin_set_dt(&event_led, on ? 1 : 0);
}

/* GPIO callback: on the STM32 this runs inside the EXTI interrupt. */
static void button_isr(const struct device *dev, struct gpio_callback *cb, uint32_t pins)
{
	ARG_UNUSED(dev);
	ARG_UNUSED(cb);

	if (!(pins & BIT(button.pin))) {
		return;
	}

#if CONFIG_APP_DEBOUNCE_MS > 0
	/*
	 * Contact bounce produces several edges per press. Accept an edge
	 * only if the last accepted one is at least DEBOUNCE_MS old. Only
	 * this ISR uses last_accepted, so no lock is needed.
	 */
	static int64_t last_accepted = -CONFIG_APP_DEBOUNCE_MS;
	int64_t now = k_uptime_get();

	if (now - last_accepted < CONFIG_APP_DEBOUNCE_MS) {
		return;
	}
	last_accepted = now;
#endif

	demo_button_pressed();
}

int main(void)
{
	int ret;

	if (!gpio_is_ready_dt(&button) || !gpio_is_ready_dt(&event_led) ||
	    !gpio_is_ready_dt(&heartbeat_led)) {
		printk("ERROR: GPIO device not ready\n");
		return 0;
	}

	ret = gpio_pin_configure_dt(&event_led, GPIO_OUTPUT_INACTIVE);
	ret |= gpio_pin_configure_dt(&heartbeat_led, GPIO_OUTPUT_INACTIVE);
	ret |= gpio_pin_configure_dt(&button, GPIO_INPUT);
	if (ret < 0) {
		printk("ERROR: could not configure GPIO pins\n");
		return 0;
	}

	ret = gpio_pin_interrupt_configure_dt(&button, GPIO_INT_EDGE_TO_ACTIVE);
	if (ret < 0) {
		printk("ERROR: could not configure button interrupt (%d)\n", ret);
		return 0;
	}

	gpio_init_callback(&button_cb, button_isr, BIT(button.pin));
	gpio_add_callback(button.port, &button_cb);

	printk("\n04_event_groups on %s\n", CONFIG_BOARD);
	demo_start();

	/* Heartbeat and periodic report, at the lowest priority. */
	int64_t next_report = k_uptime_get() + CONFIG_APP_REPORT_PERIOD_MS;

	while (1) {
		gpio_pin_toggle_dt(&heartbeat_led);
		k_msleep(HEARTBEAT_PERIOD_MS);

		if (k_uptime_get() >= next_report) {
			next_report += CONFIG_APP_REPORT_PERIOD_MS;
			demo_report();
		}
	}

	return 0;
}
```

## src/demo.h
```c
/*
 * The interface between main.c (hardware, heartbeat, reporting) and the
 * demo that is compiled in: startup_gate.c (Part A) or dispatcher.c
 * (Part B). Exactly one of them is built, selected in prj.conf.
 */
#ifndef DEMO_H_
#define DEMO_H_

#include <stdbool.h>

/* Implemented by the demo. */
void demo_start(void);           /* once, from main(), after the GPIO setup */
void demo_button_pressed(void);  /* from the button ISR (debounced): interrupt context */
void demo_report(void);          /* every CONFIG_APP_REPORT_PERIOD_MS, from main() */

/* Implemented by main.c. Both are safe to call from an ISR. */
void event_led_toggle(void);
void event_led_set(bool on);

#endif /* DEMO_H_ */
```

## src/dispatcher.c
```c
/*
 * 04_event_groups, Part B: a wait-any dispatcher
 *
 * Three sources post one bit each into the same event group:
 *
 *   bit 0  button  the blue USER button ISR (debounced in main.c)
 *   bit 1  tick    a k_timer, also in interrupt context
 *   bit 2  data    a producer thread
 *
 * One dispatcher thread waits for ANY of them with k_event_wait(). It
 * clears exactly the bits it was given, and then handles them. The
 * dispatcher is the only thread that clears: it owns the bits.
 *
 * Every post and every handling is counted per source. The difference
 * shows what an event group cannot do: count. A bit that is posted
 * again before the dispatcher has cleared it merges with the first post.
 *
 * Kconfig switches turn on the classic mistakes (experiments B2 to B4).
 */

#include <zephyr/kernel.h>
#include <zephyr/sys/atomic.h>
#include <zephyr/sys/printk.h>
#include <zephyr/sys/util.h>

#include "demo.h"

enum source { SRC_BUTTON, SRC_TICK, SRC_DATA, NUM_SOURCES };

static const char *const source_name[NUM_SOURCES] = { "button", "tick", "data" };

#define EV_ALL_SOURCES (BIT(SRC_BUTTON) | BIT(SRC_TICK) | BIT(SRC_DATA))

#define STACK_SIZE          1024
#define DISPATCHER_PRIORITY 2
#define PRODUCER_PRIORITY   5

/* The event group: 32 bits, all clear at start. */
K_EVENT_DEFINE(app_events);

static int64_t t0;

static uint32_t now_ms(void)
{
	return (uint32_t)(k_uptime_get() - t0);
}

/* Statistics, written from ISRs and threads: atomic. */
static atomic_t posted[NUM_SOURCES];
static atomic_t handled[NUM_SOURCES];
static atomic_t wakeups;
static atomic_t multi_bit_wakeups;     /* the wait returned more than one bit */
static atomic_t logger_wakeups;

/* ------------------------------------------------------------------ */
/* Producers                                                           */
/* ------------------------------------------------------------------ */

/* Safe from ISRs and threads. */
static void post_source(enum source src)
{
	/* Count first, so that a report never sees handled > posted. */
	atomic_inc(&posted[src]);
	k_event_post(&app_events, BIT(src));    /* OR in; wakes every waiter whose condition is met */
}

void demo_button_pressed(void)
{
	post_source(SRC_BUTTON);
}

#if CONFIG_APP_TICK_PERIOD_MS > 0
static void tick_expiry(struct k_timer *timer)
{
	ARG_UNUSED(timer);
	post_source(SRC_TICK);
}

K_TIMER_DEFINE(tick_timer, tick_expiry, NULL);
#endif

static void producer_thread(void *p1, void *p2, void *p3)
{
	ARG_UNUSED(p1);
	ARG_UNUSED(p2);
	ARG_UNUSED(p3);

	if (CONFIG_APP_DATA_PERIOD_MS == 0) {
		return;
	}

	while (1) {
		k_msleep(CONFIG_APP_DATA_PERIOD_MS);
		post_source(SRC_DATA);                  /* "a new block of data is ready" */
	}
}

/* ------------------------------------------------------------------ */
/* The dispatcher: the only thread that clears bits                    */
/* ------------------------------------------------------------------ */

static void handle(enum source src)
{
	atomic_inc(&handled[src]);

	if (src == SRC_BUTTON) {
		event_led_toggle();
		printk("[dispatch] t=%u ms  button press handled\n", now_ms());
	}

	k_msleep(CONFIG_APP_HANDLE_MS);                 /* simulated work */
}

static void dispatcher_thread(void *p1, void *p2, void *p3)
{
	ARG_UNUSED(p1);
	ARG_UNUSED(p2);
	ARG_UNUSED(p3);

	while (1) {
		/*
		 * Wait for ANY source. reset = false: never wipe bits before
		 * waiting. The return value says which bits woke us.
		 */
		uint32_t got = k_event_wait(&app_events, EV_ALL_SOURCES, false, K_FOREVER);

		atomic_inc(&wakeups);
		if (__builtin_popcount(got) > 1) {
			atomic_inc(&multi_bit_wakeups);
		}

#if !defined(CONFIG_APP_CLEAR_AFTER_HANDLING)
		/*
		 * Correct: claim exactly the bits we are about to handle, BEFORE
		 * handling them. A post that arrives during the handling sets
		 * the bit again, and the next wait returns at once for it.
		 */
		k_event_clear(&app_events, got);
#endif

		for (int src = 0; src < NUM_SOURCES; src++) {
			if (got & BIT(src)) {
				handle((enum source)src);
			}
		}

#if defined(CONFIG_APP_CLEAR_AFTER_HANDLING)
		/*
		 * WRONG (experiment B2): a post of the same source during the
		 * handling found the bit still set, merged with it, and is
		 * now erased without ever being handled.
		 */
		k_event_clear(&app_events, got);
#endif
	}
}

K_THREAD_DEFINE(dispatcher_tid, STACK_SIZE, dispatcher_thread, NULL, NULL, NULL,
		DISPATCHER_PRIORITY, 0, SYS_FOREVER_MS);
K_THREAD_DEFINE(producer_tid, STACK_SIZE, producer_thread, NULL, NULL, NULL,
		PRODUCER_PRIORITY, 0, SYS_FOREVER_MS);

/* ------------------------------------------------------------------ */
/* A second listener (experiments B3 and B4)                           */
/* ------------------------------------------------------------------ */

#if defined(CONFIG_APP_BUTTON_LOGGER)
/*
 * Also waits for the button bit, but never clears it: the dispatcher owns
 * the clearing. With the default priority (4, less urgent than the
 * dispatcher) the dispatcher has already cleared the bit by the time the
 * logger waits again. With priority 1 (more urgent), the bit is still set
 * when the logger waits again, so the wait returns at once, again and again.
 */
static void logger_thread(void *p1, void *p2, void *p3)
{
	ARG_UNUSED(p1);
	ARG_UNUSED(p2);
	ARG_UNUSED(p3);

	while (1) {
		uint32_t got = k_event_wait(&app_events, BIT(SRC_BUTTON), false, K_FOREVER);

		atomic_inc(&logger_wakeups);
		printk("[logger]   t=%u ms  saw the button too (bits 0x%x)\n", now_ms(), got);
	}
}

K_THREAD_DEFINE(logger_tid, STACK_SIZE, logger_thread, NULL, NULL, NULL,
		CONFIG_APP_LOGGER_PRIORITY, 0, SYS_FOREVER_MS);
#endif

/* ------------------------------------------------------------------ */
/* Called by main.c                                                    */
/* ------------------------------------------------------------------ */

void demo_start(void)
{
	k_thread_name_set(dispatcher_tid, "dispatcher");
	k_thread_name_set(producer_tid, "producer");

	printk("Part B: dispatcher. Waits for ANY of: button tick data. "
	       "Handling takes %d ms per event%s\n",
	       CONFIG_APP_HANDLE_MS,
	       IS_ENABLED(CONFIG_APP_CLEAR_AFTER_HANDLING) ? " (clears AFTER handling)" : "");
	printk("Sources: tick every %d ms, data every %d ms (0 = off), button\n",
	       CONFIG_APP_TICK_PERIOD_MS, CONFIG_APP_DATA_PERIOD_MS);

	t0 = k_uptime_get();

	k_thread_start(dispatcher_tid);
	k_thread_start(producer_tid);

#if defined(CONFIG_APP_BUTTON_LOGGER)
	k_thread_name_set(logger_tid, "logger");
	printk("Logger thread at priority %d also waits for the button bit\n",
	       CONFIG_APP_LOGGER_PRIORITY);
	k_thread_start(logger_tid);
#endif

#if CONFIG_APP_TICK_PERIOD_MS > 0
	k_timer_start(&tick_timer, K_MSEC(CONFIG_APP_TICK_PERIOD_MS),
		      K_MSEC(CONFIG_APP_TICK_PERIOD_MS));
#endif
}

void demo_report(void)
{
	uint32_t p[NUM_SOURCES], h[NUM_SOURCES];
	unsigned int key;

	/* A consistent snapshot: no ISR or thread can run between these reads. */
	key = irq_lock();
	for (int i = 0; i < NUM_SOURCES; i++) {
		p[i] = (uint32_t)atomic_get(&posted[i]);
		h[i] = (uint32_t)atomic_get(&handled[i]);
	}
	irq_unlock(key);

	printk("[report]   t=%u ms  wakeups=%d (with more than one bit: %d)",
	       now_ms(), (int)atomic_get(&wakeups), (int)atomic_get(&multi_bit_wakeups));
	if (IS_ENABLED(CONFIG_APP_BUTTON_LOGGER)) {
		printk("  logger wakeups=%d", (int)atomic_get(&logger_wakeups));
	}
	printk("\n");

	for (int i = 0; i < NUM_SOURCES; i++) {
		printk("[report]     %-6s posted=%u handled=%u not handled=%u\n",
		       source_name[i], p[i], h[i], p[i] - h[i]);
	}
}
```

## src/startup_gate.c
```c
/*
 * 04_event_groups, Part A: a wait-all start-up gate
 *
 * A worker may only transfer data when three independent conditions hold:
 *
 *   bit 0  EV_SENSOR_READY   posted once by the sensor init thread
 *   bit 1  EV_CONFIG_LOADED  posted once by the config init thread
 *   bit 2  EV_LINK_UP        posted and cleared by the link thread as the
 *                            link goes up and down (and by the button)
 *
 * The bits are STATE, not events: a bit stays set for as long as its
 * condition holds, and whoever owns the condition clears it. Nobody else
 * clears anything. The worker waits for all three with k_event_wait_all().
 * While they hold, the wait returns at once, so the worker keeps
 * transferring. When the link drops, the next wait blocks: the worker
 * pauses by itself, with no extra code.
 *
 * Kconfig switches turn on the classic mistakes (experiments A2 to A4).
 */

#include <zephyr/kernel.h>
#include <zephyr/sys/atomic.h>
#include <zephyr/sys/printk.h>
#include <zephyr/sys/util.h>

#include "demo.h"

#define EV_SENSOR_READY   BIT(0)
#define EV_CONFIG_LOADED  BIT(1)
#define EV_LINK_UP        BIT(2)
#define EV_ALL_READY      (EV_SENSOR_READY | EV_CONFIG_LOADED | EV_LINK_UP)

#define STACK_SIZE       1024
#define WORKER_PRIORITY  3
#define INIT_PRIORITY    5

/* Experiment A3. The correct value here is false. */
#define WAIT_RESET IS_ENABLED(CONFIG_APP_GATE_RESET)

/* The event group: 32 bits, all clear at start. */
K_EVENT_DEFINE(sys_events);

static int64_t t0;

static uint32_t now_ms(void)
{
	return (uint32_t)(k_uptime_get() - t0);
}

/* " sensor config link" for the bits that are set, " (none)" for none. */
static const char *bits_str(uint32_t bits, char *buf, size_t len)
{
	snprintk(buf, len, "%s%s%s%s",
		 (bits & EV_SENSOR_READY)  ? " sensor" : "",
		 (bits & EV_CONFIG_LOADED) ? " config" : "",
		 (bits & EV_LINK_UP)       ? " link"   : "",
		 (bits & EV_ALL_READY)     ? ""        : " (none)");
	return buf;
}

/*
 * Statistics. Each counter is written by one thread (or the button ISR,
 * atomically) and only read by main(). Aligned 32-bit loads and stores
 * are single instructions on the Cortex-M7.
 */
static uint32_t gate_openings;
static uint32_t transfers;
static uint32_t early_starts;     /* transfers started while a condition was missing */
static uint32_t wait_timeouts;
static atomic_t button_toggles;

/* ------------------------------------------------------------------ */
/* The condition owners                                                */
/* ------------------------------------------------------------------ */

struct init_task {
	const char *name;
	uint32_t bit;
	int delay_ms;
};

static const struct init_task init_tasks[] = {
	{ "sensor", EV_SENSOR_READY,  CONFIG_APP_SENSOR_INIT_MS },
	{ "config", EV_CONFIG_LOADED, CONFIG_APP_CONFIG_INIT_MS },
};

/* Simulates a slow initialisation, then announces it. Runs once. */
static void init_thread(void *p1, void *p2, void *p3)
{
	const struct init_task *task = &init_tasks[POINTER_TO_INT(p1)];

	ARG_UNUSED(p2);
	ARG_UNUSED(p3);

	k_msleep(task->delay_ms);

	printk("[init]   t=%u ms  %s ready (posted once, never again)\n", now_ms(), task->name);
	k_event_post(&sys_events, task->bit);      /* OR the bit in; keep the others */
}

static void link_set(bool up)
{
	if (up) {
#if defined(CONFIG_APP_LINK_USE_SET)
		/* WRONG (experiment A4): replaces all 32 bits with EV_LINK_UP. */
		k_event_set(&sys_events, EV_LINK_UP);
#else
		k_event_post(&sys_events, EV_LINK_UP);
#endif
	} else {
		k_event_clear(&sys_events, EV_LINK_UP); /* clears only this bit */
	}
}

/* The link comes up, stays up for a while, drops, and comes back. */
static void link_thread(void *p1, void *p2, void *p3)
{
	ARG_UNUSED(p1);
	ARG_UNUSED(p2);
	ARG_UNUSED(p3);

	k_msleep(CONFIG_APP_LINK_INIT_MS);

	while (1) {
		printk("[link]   t=%u ms  up\n", now_ms());
		link_set(true);

		if (CONFIG_APP_LINK_UP_TIME_MS == 0) {
			return;                         /* stays up for ever */
		}
		k_msleep(CONFIG_APP_LINK_UP_TIME_MS);

		link_set(false);
		printk("[link]   t=%u ms  down\n", now_ms());
		k_msleep(CONFIG_APP_LINK_DOWN_TIME_MS);
	}
}

/* The button "unplugs" or "replugs" the cable. ISR context: all ISR-safe. */
void demo_button_pressed(void)
{
	atomic_inc(&button_toggles);

	if (k_event_test(&sys_events, EV_LINK_UP)) {
		link_set(false);
	} else {
		link_set(true);
	}
}

/* ------------------------------------------------------------------ */
/* The worker                                                          */
/* ------------------------------------------------------------------ */

static void worker_thread(void *p1, void *p2, void *p3)
{
	char buf[32];
	bool open = false;
	uint32_t last_reported_bad = 0;

	ARG_UNUSED(p1);
	ARG_UNUSED(p2);
	ARG_UNUSED(p3);

	while (1) {
		/*
		 * Block until ALL three bits are set. Returns the matching
		 * bits, or 0 on timeout. The bits are NOT cleared: they are
		 * conditions owned by other threads.
		 */
#if defined(CONFIG_APP_GATE_WAIT_ANY)
		/* WRONG (experiment A2): returns as soon as ANY bit is set. */
		uint32_t got = k_event_wait(&sys_events, EV_ALL_READY, WAIT_RESET,
					    K_MSEC(CONFIG_APP_GATE_TIMEOUT_MS));
#else
		uint32_t got = k_event_wait_all(&sys_events, EV_ALL_READY, WAIT_RESET,
						K_MSEC(CONFIG_APP_GATE_TIMEOUT_MS));
#endif

		if (got == 0) {
			wait_timeouts++;
			uint32_t missing = EV_ALL_READY & ~k_event_test(&sys_events, EV_ALL_READY);

			printk("[worker] t=%u ms  still waiting, missing:%s\n", now_ms(),
			       bits_str(missing, buf, sizeof(buf)));
			continue;
		}

		/* What holds right now? With wait-all this is always all three. */
		uint32_t now = k_event_test(&sys_events, EV_ALL_READY);

		if (now == EV_ALL_READY) {
			if (!open) {
				open = true;
				last_reported_bad = 0;
				gate_openings++;
				event_led_set(true);
				printk("[worker] t=%u ms  gate open, the wait returned:%s\n",
				       now_ms(), bits_str(got, buf, sizeof(buf)));
			}
		} else {
			/* Only reachable with the wrong wait (experiment A2). */
			early_starts++;
			if (now != last_reported_bad) {
				last_reported_bad = now;
				printk("[worker] t=%u ms  BUG: transfer started, missing:%s\n",
				       now_ms(), bits_str(EV_ALL_READY & ~now, buf, sizeof(buf)));
			}
		}

		/* The work. Conditions can change while it runs. */
		k_msleep(CONFIG_APP_TRANSFER_MS);
		transfers++;

		now = k_event_test(&sys_events, EV_ALL_READY);
		if (open && now != EV_ALL_READY) {
			open = false;
			event_led_set(false);
			printk("[worker] t=%u ms  gate closed, missing:%s\n", now_ms(),
			       bits_str(EV_ALL_READY & ~now, buf, sizeof(buf)));
		}
	}
}

/* Created at boot but not started: demo_start() starts them, so that all
 * times are measured from the same moment t0.
 */
K_THREAD_DEFINE(worker_tid, STACK_SIZE, worker_thread, NULL, NULL, NULL,
		WORKER_PRIORITY, 0, SYS_FOREVER_MS);
K_THREAD_DEFINE(sensor_tid, STACK_SIZE, init_thread, INT_TO_POINTER(0), NULL, NULL,
		INIT_PRIORITY, 0, SYS_FOREVER_MS);
K_THREAD_DEFINE(config_tid, STACK_SIZE, init_thread, INT_TO_POINTER(1), NULL, NULL,
		INIT_PRIORITY, 0, SYS_FOREVER_MS);
K_THREAD_DEFINE(link_tid, STACK_SIZE, link_thread, NULL, NULL, NULL,
		INIT_PRIORITY, 0, SYS_FOREVER_MS);

/* ------------------------------------------------------------------ */
/* Called by main.c                                                    */
/* ------------------------------------------------------------------ */

void demo_start(void)
{
	char buf[32];

	k_thread_name_set(worker_tid, "worker");
	k_thread_name_set(sensor_tid, "sensor_init");
	k_thread_name_set(config_tid, "config_init");
	k_thread_name_set(link_tid, "link");

	printk("Part A: start-up gate. The worker waits for %s of:%s%s%s\n",
	       IS_ENABLED(CONFIG_APP_GATE_WAIT_ANY) ? "ANY" : "ALL",
	       bits_str(EV_ALL_READY, buf, sizeof(buf)),
	       IS_ENABLED(CONFIG_APP_GATE_RESET) ? "  (reset = true)" : "",
	       IS_ENABLED(CONFIG_APP_LINK_USE_SET) ? "  (link uses k_event_set)" : "");

	t0 = k_uptime_get();

	/* The worker first (priority 3 runs at once and blocks in its wait). */
	k_thread_start(worker_tid);
	k_thread_start(sensor_tid);
	k_thread_start(config_tid);
	k_thread_start(link_tid);
}

void demo_report(void)
{
	char buf[32];

	printk("[gate]   t=%u ms  bits now:%s  openings=%u transfers=%u early=%u "
	       "timeouts=%u button=%d\n",
	       now_ms(), bits_str(k_event_test(&sys_events, EV_ALL_READY), buf, sizeof(buf)),
	       gate_openings, transfers, early_starts, wait_timeouts,
	       (int)atomic_get(&button_toggles));
}
```
