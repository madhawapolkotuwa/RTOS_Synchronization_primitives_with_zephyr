## CMakeLists.txt
```
cmake_minimum_required(VERSION 3.20.0)

find_package(Zephyr REQUIRED HINTS $ENV{ZEPHYR_BASE})
project(message_queues)

target_sources(app PRIVATE src/main.c)
# Exactly one demo is compiled in, chosen in prj.conf (see Kconfig).
target_sources_ifdef(CONFIG_APP_DEMO_SENSOR  app PRIVATE src/sensor_pipeline.c)
target_sources_ifdef(CONFIG_APP_DEMO_PACKETS app PRIVATE src/packet_pool.c)
```

## Kconfig
```
# Application options for 06_message_queues.
# Change them in prj.conf; no code edits are needed for the experiments.

mainmenu "06_message_queues"

choice APP_DEMO
	prompt "Which demo to build"
	default APP_DEMO_SENSOR

config APP_DEMO_SENSOR
	bool "Part A: sensor samples by copy through a k_msgq"

config APP_DEMO_PACKETS
	bool "Part B: packets by reference through a k_fifo, from a k_mem_slab pool"

endchoice

config APP_REPORT_PERIOD_MS
	int "Period of the statistics report printed by main (ms)"
	default 2000

config APP_DEBOUNCE_MS
	int "Ignore button edges closer than this to the last accepted one (ms, 0 = off)"
	default 50

# --- Part A: used only when APP_DEMO_SENSOR is selected ---

config APP_SAMPLE_PERIOD_US
	int "The sensor interrupt delivers one sample every ... us"
	default 1000
	range 100 100000

config APP_QUEUE_DEPTH
	int "Depth of the sample queue (messages)"
	default 16
	range 1 1024

config APP_PROCESS_US
	int "CPU time the processing thread spends on one sample (us)"
	default 300
	range 1 100000

config APP_BLOCK_PERIOD_MS
	int "Higher-priority work starts every ... ms"
	default 100
	range 10 10000

config APP_BLOCK_MS
	int "How long that work keeps the CPU each time (ms, 0 = none)"
	default 9
	help
	  The worst-case time the processing thread cannot run: Lesson 08's
	  "5 ms radio burst plus 4 ms control update".

config APP_BUTTON_BLOCK_MS
	int "The button makes the next block of higher-priority work this long (ms)"
	default 30

choice APP_FULL_POLICY
	prompt "What the sensor ISR does when the queue is full"
	default APP_POLICY_DROP_NEWEST

config APP_POLICY_DROP_NEWEST
	bool "Drop the new sample (count it)"

config APP_POLICY_DROP_OLDEST
	bool "Drop the oldest queued sample, then queue the new one"

endchoice

config APP_ISR_PUT_WAIT
	bool "Experiment A4: the ISR puts with a 1 ms timeout instead of K_NO_WAIT (wrong)"

# --- Part B: used only when APP_DEMO_PACKETS is selected ---

config APP_PACKET_PERIOD_MS
	int "The receive interrupt delivers one packet every ... ms"
	default 10
	range 1 10000

config APP_POOL_BLOCKS
	int "Number of packet buffers in the k_mem_slab pool"
	default 8
	range 1 256

config APP_HANDLE_MS
	int "Time the consumer spends on one packet (ms, sleeping)"
	default 4
	range 1 10000

config APP_STALL_MS
	int "The button makes the consumer spend this long on the next packet (ms)"
	default 50

config APP_FORGET_FREE
	bool "Experiment B2: the consumer never returns the buffers to the pool (wrong)"

config APP_TOUCH_AFTER_SEND
	bool "Experiment B3: the ISR writes into a packet 2 ms after sending it (wrong)"

config APP_FIFO_NO_RESERVED
	bool "Experiment B4: the packet struct has no reserved first word for k_fifo (wrong)"

source "Kconfig.zephyr"
```

## prj.conf
```kconfig
# --- Kernel objects ---
# k_msgq, k_fifo and k_mem_slab are always available: nothing to enable.

# --- Drivers ---
CONFIG_GPIO=y

# --- Scheduling ---
# main() blinks a heartbeat LED and prints reports: least urgent priority.
# Lower number = higher priority.
#   Part A: other work 2, processing thread 5.
#   Part B: consumer 5.
CONFIG_MAIN_THREAD_PRIORITY=7
CONFIG_THREAD_NAME=y

# --- Debugging ---
CONFIG_ASSERT=y

# --- Which demo: uncomment exactly one line ---
CONFIG_APP_DEMO_SENSOR=y
# CONFIG_APP_DEMO_PACKETS=y

# --- Common options (see Kconfig) ---
CONFIG_APP_REPORT_PERIOD_MS=2000
CONFIG_APP_DEBOUNCE_MS=50

# --- Part A options ---
CONFIG_APP_SAMPLE_PERIOD_US=1000
CONFIG_APP_QUEUE_DEPTH=16
CONFIG_APP_PROCESS_US=300
CONFIG_APP_BLOCK_PERIOD_MS=100
CONFIG_APP_BLOCK_MS=9
CONFIG_APP_BUTTON_BLOCK_MS=30
# Full-queue policy: uncomment exactly one line.
CONFIG_APP_POLICY_DROP_NEWEST=y
# CONFIG_APP_POLICY_DROP_OLDEST=y
# Experiment A4:
# CONFIG_APP_ISR_PUT_WAIT=y

# --- Part B options ---
CONFIG_APP_PACKET_PERIOD_MS=10
CONFIG_APP_POOL_BLOCKS=8
CONFIG_APP_HANDLE_MS=4
CONFIG_APP_STALL_MS=50
# Experiments: uncomment one at a time.
# CONFIG_APP_FORGET_FREE=y
# CONFIG_APP_TOUCH_AFTER_SEND=y
# CONFIG_APP_FIFO_NO_RESERVED=y
```

## src/main.c
```c
/*
 * 06_message_queues: common part
 * Board: STM32F769I-DISCO, Zephyr RTOS
 *
 * This file owns the hardware: the blue USER button, the red event LED
 * (LD1) and the green heartbeat LED (LD2). It sets them up, debounces the
 * button and forwards presses to the demo, and then runs at the lowest
 * priority, blinking the heartbeat and calling demo_report().
 *
 * The queue work is in the demo file that prj.conf selects:
 *   Part A  src/sensor_pipeline.c  ISR -> k_msgq -> processing thread (by copy)
 *   Part B  src/packet_pool.c      ISR -> k_fifo of k_mem_slab blocks (by reference)
 *
 * Theory: resources/webpages/08_message_queues.html
 */

#include <zephyr/kernel.h>
#include <zephyr/drivers/gpio.h>
#include <zephyr/sys/printk.h>

#include "demo.h"

#define HEARTBEAT_PERIOD_MS 500

static const struct gpio_dt_spec button        = GPIO_DT_SPEC_GET(DT_ALIAS(sw0), gpios);
static const struct gpio_dt_spec event_led     = GPIO_DT_SPEC_GET(DT_ALIAS(led0), gpios);
static const struct gpio_dt_spec heartbeat_led = GPIO_DT_SPEC_GET(DT_ALIAS(led1), gpios);

static struct gpio_callback button_cb;

void event_led_toggle(void)
{
	gpio_pin_toggle_dt(&event_led);
}

void event_led_set(bool on)
{
	gpio_pin_set_dt(&event_led, on ? 1 : 0);
}

/* GPIO callback: on the STM32 this runs inside the EXTI interrupt. */
static void button_isr(const struct device *dev, struct gpio_callback *cb, uint32_t pins)
{
	ARG_UNUSED(dev);
	ARG_UNUSED(cb);

	if (!(pins & BIT(button.pin))) {
		return;
	}

#if CONFIG_APP_DEBOUNCE_MS > 0
	/*
	 * Contact bounce produces several edges per press. Accept an edge
	 * only if the last accepted one is at least DEBOUNCE_MS old. Only
	 * this ISR uses last_accepted, so no lock is needed.
	 */
	static int64_t last_accepted = -CONFIG_APP_DEBOUNCE_MS;
	int64_t now = k_uptime_get();

	if (now - last_accepted < CONFIG_APP_DEBOUNCE_MS) {
		return;
	}
	last_accepted = now;
#endif

	demo_button_pressed();
}

int main(void)
{
	int ret;

	if (!gpio_is_ready_dt(&button) || !gpio_is_ready_dt(&event_led) ||
	    !gpio_is_ready_dt(&heartbeat_led)) {
		printk("ERROR: GPIO device not ready\n");
		return 0;
	}

	ret = gpio_pin_configure_dt(&event_led, GPIO_OUTPUT_INACTIVE);
	ret |= gpio_pin_configure_dt(&heartbeat_led, GPIO_OUTPUT_INACTIVE);
	ret |= gpio_pin_configure_dt(&button, GPIO_INPUT);
	if (ret < 0) {
		printk("ERROR: could not configure GPIO pins\n");
		return 0;
	}

	ret = gpio_pin_interrupt_configure_dt(&button, GPIO_INT_EDGE_TO_ACTIVE);
	if (ret < 0) {
		printk("ERROR: could not configure button interrupt (%d)\n", ret);
		return 0;
	}

	gpio_init_callback(&button_cb, button_isr, BIT(button.pin));
	gpio_add_callback(button.port, &button_cb);

	printk("\n06_message_queues on %s\n", CONFIG_BOARD);
	demo_start();

	/* Heartbeat and periodic report, at the lowest priority. */
	int64_t next_report = k_uptime_get() + CONFIG_APP_REPORT_PERIOD_MS;

	while (1) {
		gpio_pin_toggle_dt(&heartbeat_led);
		k_msleep(HEARTBEAT_PERIOD_MS);

		if (k_uptime_get() >= next_report) {
			next_report += CONFIG_APP_REPORT_PERIOD_MS;
			demo_report();
		}
	}

	return 0;
}
```

## src/demo.h
```c
/*
 * The interface between main.c (hardware, heartbeat, reporting) and the
 * demo that is compiled in: sensor_pipeline.c (Part A) or packet_pool.c
 * (Part B). Exactly one of them is built, selected in prj.conf.
 */
#ifndef DEMO_H_
#define DEMO_H_

#include <stdbool.h>

/* Implemented by the demo. */
void demo_start(void);           /* once, from main(), after the GPIO setup */
void demo_button_pressed(void);  /* from the button ISR (debounced): interrupt context */
void demo_report(void);          /* every CONFIG_APP_REPORT_PERIOD_MS, from main() */

/* Implemented by main.c. Both are safe to call from an ISR. */
void event_led_toggle(void);
void event_led_set(bool on);

#endif /* DEMO_H_ */
```

## src/packet_pool.c
```c
/*
 * 06_message_queues, Part B: packets by reference
 *
 * A packet of 256 bytes is too big to copy twice through a message queue.
 * Instead, the receive interrupt takes a free buffer from a fixed-block
 * pool (k_mem_slab), fills it, and passes only its address to the
 * consumer through a k_fifo. The rule that makes this safe is ownership
 * transfer:
 *
 *   ISR:       alloc from the pool -> fill -> k_fifo_put   (and never touch it again)
 *   consumer:  k_fifo_get -> process -> k_mem_slab_free   (it owns it until the free)
 *
 * The consumer checks every packet: a checksum over the payload, and a
 * copy of the sequence number at the end of the packet against the one
 * at the start. Kconfig switches break the rule in three classic ways
 * (experiments B2 to B4).
 */

#include <zephyr/kernel.h>
#include <zephyr/sys/atomic.h>
#include <zephyr/sys/printk.h>
#include <zephyr/sys/util.h>

#include "demo.h"

#define STACK_SIZE         1024
#define CONSUMER_PRIORITY  5
#define PAYLOAD_SIZE       240
#define TOUCH_DELAY_MS     2

struct packet {
#if !defined(CONFIG_APP_FIFO_NO_RESERVED)
	void *fifo_reserved;     /* first word: k_fifo links its items through it */
#endif
	uint32_t seq;            /* first data word: overwritten if there is no reserved word */
	uint32_t len;
	uint8_t payload[PAYLOAD_SIZE];
	uint32_t checksum;       /* over payload[] */
	uint32_t seq_copy;       /* the same as seq, at the far end of the packet */
};

/* CONFIG_APP_POOL_BLOCKS buffers of sizeof(struct packet) bytes, aligned to 4. */
K_MEM_SLAB_DEFINE(packet_pool, sizeof(struct packet), CONFIG_APP_POOL_BLOCKS, 4);
K_FIFO_DEFINE(packet_fifo);

static int64_t t0;

static uint32_t now_ms(void)
{
	return (uint32_t)(k_uptime_get() - t0);
}

static uint32_t payload_checksum(const struct packet *p)
{
	uint32_t sum = 0;

	for (int i = 0; i < PAYLOAD_SIZE; i++) {
		sum += p->payload[i];
	}
	return sum;
}

/* ------------------------------------------------------------------ */
/* The producer: the receive interrupt                                 */
/* ------------------------------------------------------------------ */

/* Written only by the ISR, read by demo_report(). */
static atomic_t sent, dropped, max_in_use;

#if defined(CONFIG_APP_TOUCH_AFTER_SEND)
static struct packet *last_sent;

/* WRONG (experiment B3): "the DMA was still writing" into a packet it gave away. */
static void touch_isr(struct k_timer *timer)
{
	ARG_UNUSED(timer);
	last_sent->payload[0] ^= 0xFF;
}

K_TIMER_DEFINE(touch_timer, touch_isr, NULL);
#endif

static void packet_isr(struct k_timer *timer)
{
	static uint32_t seq;
	struct packet *p;

	ARG_UNUSED(timer);

	seq++;                               /* a dropped packet leaves a gap */

	/* An ISR must not wait for a free buffer. No buffer: drop and count. */
	if (k_mem_slab_alloc(&packet_pool, (void **)&p, K_NO_WAIT) != 0) {
		atomic_inc(&dropped);
		event_led_set(true);             /* red LED: latched at the first problem */
		return;
	}

	uint32_t in_use = k_mem_slab_num_used_get(&packet_pool);

	if (in_use > (uint32_t)atomic_get(&max_in_use)) {
		atomic_set(&max_in_use, in_use);
	}

	/* "Receive" the packet: a real driver's DMA would fill the buffer. */
	p->seq = seq;
	p->len = PAYLOAD_SIZE;
	for (int i = 0; i < PAYLOAD_SIZE; i++) {
		p->payload[i] = (uint8_t)(seq + i);
	}
	p->checksum = payload_checksum(p);
	p->seq_copy = seq;

	/* Hand it over. From here on the consumer owns it. Only the address is copied. */
	k_fifo_put(&packet_fifo, p);
	atomic_inc(&sent);

#if defined(CONFIG_APP_TOUCH_AFTER_SEND)
	last_sent = p;
	k_timer_start(&touch_timer, K_MSEC(TOUCH_DELAY_MS), K_NO_WAIT);
#endif
}

K_TIMER_DEFINE(packet_timer, packet_isr, NULL);

/* ------------------------------------------------------------------ */
/* The consumer                                                        */
/* ------------------------------------------------------------------ */

/* Written only by the consumer, read by demo_report() under irq_lock(). */
static uint32_t received, freed, bad_checksum, bad_header, last_bad_header;
static atomic_t stall_next;

static void consumer_thread(void *p1, void *p2, void *p3)
{
	ARG_UNUSED(p1);
	ARG_UNUSED(p2);
	ARG_UNUSED(p3);

	while (1) {
		struct packet *p = k_fifo_get(&packet_fifo, K_FOREVER);

		received++;

		/* "Process" it: waits for something else, such as a flash write. */
		k_msleep(atomic_clear(&stall_next) ? CONFIG_APP_STALL_MS : CONFIG_APP_HANDLE_MS);

		/* The processing has read the whole packet: was it intact? */
		if (payload_checksum(p) != p->checksum) {
			bad_checksum++;
			event_led_set(true);
		}
		if (p->seq != p->seq_copy) {
			bad_header++;
			last_bad_header = p->seq;
			event_led_set(true);
		}

#if !defined(CONFIG_APP_FORGET_FREE)
		k_mem_slab_free(&packet_pool, p);   /* give it back; p is no longer ours */
		freed++;
#endif
	}
}

K_THREAD_DEFINE(consumer_tid, STACK_SIZE, consumer_thread, NULL, NULL, NULL,
		CONSUMER_PRIORITY, 0, SYS_FOREVER_MS);

/* ------------------------------------------------------------------ */
/* Called by main.c                                                    */
/* ------------------------------------------------------------------ */

/* The consumer is slow on the next packet. ISR context. */
void demo_button_pressed(void)
{
	atomic_set(&stall_next, 1);
}

void demo_start(void)
{
	k_thread_name_set(consumer_tid, "consumer");

	printk("Part B: receive ISR -> k_fifo -> consumer, %u-byte packets by reference\n",
	       (unsigned int)sizeof(struct packet));
	printk("  a packet every %d ms; pool of %d buffers (%u bytes); %d ms per packet%s\n",
	       CONFIG_APP_PACKET_PERIOD_MS, CONFIG_APP_POOL_BLOCKS,
	       (unsigned int)(CONFIG_APP_POOL_BLOCKS * sizeof(struct packet)),
	       CONFIG_APP_HANDLE_MS,
	       IS_ENABLED(CONFIG_APP_FIFO_NO_RESERVED) ? "; NO reserved first word" : "");

	t0 = k_uptime_get();
	k_thread_start(consumer_tid);

	/* First packet half a period in, so that a report never cuts one. */
	k_timer_start(&packet_timer, K_MSEC(CONFIG_APP_PACKET_PERIOD_MS / 2),
		      K_MSEC(CONFIG_APP_PACKET_PERIOD_MS));
}

void demo_report(void)
{
	uint32_t s, d, mx, used, r, f, bc, bh, lbh;
	unsigned int key;

	/* A consistent snapshot: no ISR or thread can run between these reads. */
	key = irq_lock();
	s = (uint32_t)atomic_get(&sent);
	d = (uint32_t)atomic_get(&dropped);
	mx = (uint32_t)atomic_get(&max_in_use);
	used = k_mem_slab_num_used_get(&packet_pool);
	r = received; f = freed; bc = bad_checksum; bh = bad_header; lbh = last_bad_header;
	irq_unlock(key);

	printk("[report] t=%u ms  sent=%u dropped=%u received=%u freed=%u  "
	       "buffers in use now=%u max=%u/%d\n",
	       now_ms(), s, d, r, f, used, mx, CONFIG_APP_POOL_BLOCKS);
	printk("[report]   bad checksum=%u  header overwritten=%u (last value 0x%08x)\n",
	       bc, bh, lbh);
}
```

## src/sensor_pipeline.c
```c
/*
 * 06_message_queues, Part A: a sensor pipeline, by copy
 *
 * Lesson 08's worked example. A sensor interrupt delivers one sample every
 * millisecond and puts it into a k_msgq without waiting. A processing
 * thread takes the samples out and spends 0.3 ms of CPU on each. On
 * average it keeps up easily (30 % load). But higher-priority work keeps
 * it off the CPU for 9 ms every 100 ms, and the queue must absorb what
 * arrives meanwhile.
 *
 * The ISR counts the samples it could not queue and records the highest
 * fill level. The processing thread checks the sequence numbers and the
 * age of each sample. Together they validate the queue depth: Lesson 08
 * says it must be at least 9 messages.
 *
 * Kconfig switches change the depth, the timing and the full-queue policy
 * (experiments A1 to A4).
 */

#include <errno.h>
#include <zephyr/kernel.h>
#include <zephyr/sys/atomic.h>
#include <zephyr/sys/printk.h>
#include <zephyr/sys/util.h>

#include "demo.h"

#define STACK_SIZE           1024
#define PROCESSING_PRIORITY  5
#define OTHER_WORK_PRIORITY  2

/* One sample: 3 accelerometer and 3 gyroscope axes, plus bookkeeping. */
struct sample {
	uint32_t seq;            /* 1, 2, 3, ...: a gap means a lost sample */
	uint32_t stamp;          /* cycle counter when the ISR read the sensor */
	int16_t accel[3];
	int16_t gyro[3];
};

/* depth x sizeof(struct sample) bytes, reserved at build time. Aligned to 4. */
K_MSGQ_DEFINE(sample_q, sizeof(struct sample), CONFIG_APP_QUEUE_DEPTH, 4);

#if defined(CONFIG_APP_ISR_PUT_WAIT)
#define PUT_TIMEOUT K_MSEC(1)            /* WRONG (experiment A4): an ISR cannot wait */
#else
#define PUT_TIMEOUT K_NO_WAIT
#endif

static int64_t t0;

static uint32_t now_ms(void)
{
	return (uint32_t)(k_uptime_get() - t0);
}

/* ------------------------------------------------------------------ */
/* The producer: the sensor interrupt                                  */
/* ------------------------------------------------------------------ */

/* Written only by the ISR, read by demo_report(). */
static atomic_t produced;
static atomic_t dropped;
static atomic_t max_fill;

static void sample_isr(struct k_timer *timer)
{
	static uint32_t seq;
	struct sample s;
	int ret;

	ARG_UNUSED(timer);

	/* "Read the sensor": made-up values, a real ISR would read registers. */
	s.seq = ++seq;
	s.stamp = k_cycle_get_32();
	for (int i = 0; i < 3; i++) {
		s.accel[i] = (int16_t)(seq * (i + 1));
		s.gyro[i] = (int16_t)(seq * (i + 4));
	}
	atomic_inc(&produced);

	/* Copied into the queue: s may go out of scope right after. */
	ret = k_msgq_put(&sample_q, &s, PUT_TIMEOUT);

#if defined(CONFIG_APP_POLICY_DROP_OLDEST)
	if (ret != 0) {
		struct sample oldest;

		/* Make room: discard the head, then queue the new sample. */
		(void)k_msgq_get(&sample_q, &oldest, K_NO_WAIT);
		atomic_inc(&dropped);
		ret = k_msgq_put(&sample_q, &s, K_NO_WAIT);
	}
#endif
	if (ret != 0) {
		atomic_inc(&dropped);            /* -ENOMSG: the queue was full */
	}
	if (atomic_get(&dropped) > 0) {
		event_led_set(true);             /* red LED: latched at the first drop */
	}

	uint32_t fill = k_msgq_num_used_get(&sample_q);

	if (fill > (uint32_t)atomic_get(&max_fill)) {
		atomic_set(&max_fill, fill);
	}
}

K_TIMER_DEFINE(sample_timer, sample_isr, NULL);

/* ------------------------------------------------------------------ */
/* The consumer: the processing thread                                 */
/* ------------------------------------------------------------------ */

/* Written only by the processing thread, read by demo_report() under irq_lock(). */
static uint32_t received, gaps, missing, gap_first, gap_last, max_age_us;

static void processing_thread(void *p1, void *p2, void *p3)
{
	struct sample s;
	uint32_t expected = 1;

	ARG_UNUSED(p1);
	ARG_UNUSED(p2);
	ARG_UNUSED(p3);

	while (1) {
		k_msgq_get(&sample_q, &s, K_FOREVER);   /* copied out: s is ours */

		uint32_t age = k_cyc_to_us_floor32(k_cycle_get_32() - s.stamp);

		received++;
		max_age_us = MAX(max_age_us, age);
		if (s.seq != expected) {
			gaps++;
			missing += s.seq - expected;
			gap_first = expected;
			gap_last = s.seq - 1;
		}
		expected = s.seq + 1;

		k_busy_wait(CONFIG_APP_PROCESS_US);     /* the "sensor fusion": CPU time */
	}
}

K_THREAD_DEFINE(processing_tid, STACK_SIZE, processing_thread, NULL, NULL, NULL,
		PROCESSING_PRIORITY, 0, SYS_FOREVER_MS);

/* ------------------------------------------------------------------ */
/* Higher-priority work: the reason the consumer is sometimes late     */
/* ------------------------------------------------------------------ */

static atomic_t button_block;

static void other_work_thread(void *p1, void *p2, void *p3)
{
	/* Half a period in, so that the blocks never coincide with a report. */
	int64_t next = k_uptime_get() + CONFIG_APP_BLOCK_PERIOD_MS / 2;

	ARG_UNUSED(p1);
	ARG_UNUSED(p2);
	ARG_UNUSED(p3);

	while (1) {
		k_sleep(K_TIMEOUT_ABS_MS(next));
		next += CONFIG_APP_BLOCK_PERIOD_MS;

		int ms = atomic_clear(&button_block) ? CONFIG_APP_BUTTON_BLOCK_MS
						     : CONFIG_APP_BLOCK_MS;

		if (ms > 0) {
			k_busy_wait((uint32_t)ms * 1000U);  /* "radio burst + control update" */
		}
	}
}

K_THREAD_DEFINE(other_work_tid, STACK_SIZE, other_work_thread, NULL, NULL, NULL,
		OTHER_WORK_PRIORITY, 0, SYS_FOREVER_MS);

/* ------------------------------------------------------------------ */
/* Called by main.c                                                    */
/* ------------------------------------------------------------------ */

/* The next block of higher-priority work is longer. ISR context. */
void demo_button_pressed(void)
{
	atomic_set(&button_block, 1);
}

void demo_start(void)
{
	k_thread_name_set(processing_tid, "processing");
	k_thread_name_set(other_work_tid, "other_work");

	printk("Part A: sensor ISR -> k_msgq -> processing thread, %u-byte samples by copy\n",
	       (unsigned int)sizeof(struct sample));
	printk("  a sample every %d us; queue depth %d (%u bytes); processing %d us per sample\n",
	       CONFIG_APP_SAMPLE_PERIOD_US, CONFIG_APP_QUEUE_DEPTH,
	       (unsigned int)(CONFIG_APP_QUEUE_DEPTH * sizeof(struct sample)),
	       CONFIG_APP_PROCESS_US);
	printk("  other work at priority %d: %d ms every %d ms; full queue: drop the %s\n",
	       OTHER_WORK_PRIORITY, CONFIG_APP_BLOCK_MS, CONFIG_APP_BLOCK_PERIOD_MS,
	       IS_ENABLED(CONFIG_APP_POLICY_DROP_OLDEST) ? "oldest" : "newest");

	t0 = k_uptime_get();
	k_thread_start(processing_tid);
	k_thread_start(other_work_tid);
	k_timer_start(&sample_timer, K_USEC(CONFIG_APP_SAMPLE_PERIOD_US),
		      K_USEC(CONFIG_APP_SAMPLE_PERIOD_US));
}

void demo_report(void)
{
	uint32_t p, d, mf, now_fill, r, g, m, gf, gl, age;
	unsigned int key;

	/* A consistent snapshot: no ISR or thread can run between these reads. */
	key = irq_lock();
	p = (uint32_t)atomic_get(&produced);
	d = (uint32_t)atomic_get(&dropped);
	mf = (uint32_t)atomic_get(&max_fill);
	now_fill = k_msgq_num_used_get(&sample_q);
	r = received; g = gaps; m = missing; gf = gap_first; gl = gap_last; age = max_age_us;
	irq_unlock(key);

	printk("[report] t=%u ms  produced=%u received=%u dropped=%u  queue now=%u max=%u/%d  "
	       "max age=%u us\n", now_ms(), p, r, d, now_fill, mf, CONFIG_APP_QUEUE_DEPTH, age);

	if (g == 0) {
		printk("[report]   no gaps in the sequence numbers\n");
	} else if (gf == gl) {
		printk("[report]   %u gaps, %u samples missing; last gap: seq %u\n", g, m, gf);
	} else {
		printk("[report]   %u gaps, %u samples missing; last gap: seq %u..%u\n",
		       g, m, gf, gl);
	}
}
```
