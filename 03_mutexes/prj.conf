## CMakeLists.txt
```
cmake_minimum_required(VERSION 3.20.0)

find_package(Zephyr REQUIRED HINTS $ENV{ZEPHYR_BASE})
project(mutexes)

target_sources(app PRIVATE
	src/main.c
	src/bus.c
	src/sensors.c
	src/ownership_tour.c
)
```

## Kconfig
```
# Application options for 03_mutexes.
# Change them in prj.conf; no code edits are needed for most experiments.

mainmenu "03_mutexes"

choice APP_BUS_LOCK
	prompt "What protects the shared bus"
	default APP_LOCK_MUTEX

config APP_LOCK_MUTEX
	bool "A k_mutex (correct)"

config APP_LOCK_SEMAPHORE
	bool "A binary k_sem used as a lock (wrong tool)"
	help
	  Works until a thread locks twice: a semaphore is not recursive,
	  so the second take waits for a give that only the same thread
	  could do.

config APP_LOCK_NONE
	bool "Nothing (broken)"
	help
	  Transactions of the two sensor threads interleave on the bus.

endchoice

config APP_BUS_STEP_US
	int "Simulated time of one bus step (us)"
	default 100
	help
	  One step is roughly one byte on a 100 kHz I2C bus. A register
	  read has three steps, so it keeps the bus busy for 3 x this.

config APP_LOCK_TIMEOUT_MS
	int "How long a thread waits for the bus lock (ms)"
	default 100
	help
	  On timeout the lock call returns -EAGAIN, the transaction is
	  skipped and counted as a lock timeout.

config APP_ACCEL_WORK_IN_LOCK_MS
	int "Processing time the accelerometer thread spends while still holding the lock (ms)"
	default 0
	help
	  0 = correct: release the bus before processing. Anything else
	  shows the cost of a critical section that is too large.

config APP_OWNERSHIP_TOUR
	bool "Run the ownership tour at startup"
	default y

config APP_REPORT_PERIOD_MS
	int "Period of the statistics report (ms)"
	default 2000

source "Kconfig.zephyr"
```

## prj.conf
```kconfig
# --- Drivers ---
CONFIG_GPIO=y

# --- Scheduling ---
# main() blinks a heartbeat LED and prints reports: least urgent priority.
# Lower number = higher priority. Accelerometer thread: 4, temperature thread: 6.
CONFIG_MAIN_THREAD_PRIORITY=7
CONFIG_THREAD_NAME=y

# --- Debugging ---
# Catches illegal kernel calls, e.g. a mutex used in an ISR (experiment 5).
CONFIG_ASSERT=y

# --- What protects the bus: uncomment exactly one line ---
CONFIG_APP_LOCK_MUTEX=y
# CONFIG_APP_LOCK_SEMAPHORE=y
# CONFIG_APP_LOCK_NONE=y

# --- Tutorial options (see Kconfig) ---
CONFIG_APP_BUS_STEP_US=100
CONFIG_APP_LOCK_TIMEOUT_MS=100
CONFIG_APP_ACCEL_WORK_IN_LOCK_MS=0
CONFIG_APP_OWNERSHIP_TOUR=y
CONFIG_APP_REPORT_PERIOD_MS=2000
```

## src/main.c
```c
/*
 * 03_mutexes: protecting a shared bus with a mutex
 * Board: STM32F769I-DISCO, Zephyr RTOS
 *
 * Two sensor threads of different priority read devices on one simulated
 * I2C bus (bus.c, sensors.c). prj.conf chooses what protects the bus: a
 * k_mutex, a binary semaphore, or nothing. The report shows how many
 * reads were torn by interleaving, and how many timed out on the lock.
 *
 * At startup, an ownership tour (ownership_tour.c) shows the rules of
 * mutex ownership as return codes.
 *
 * main() sets up the LEDs and the button, runs the tour, starts the
 * sensors, and then blinks the heartbeat and prints the report at the
 * lowest priority.
 *
 *   green LED LD2  heartbeat
 *   red LED LD1    toggles on every bad (torn) read
 *   USER button    prints a report immediately
 *
 * Theory: resources/webpages/06_mutexes.html
 */

#include <zephyr/kernel.h>
#include <zephyr/drivers/gpio.h>
#include <zephyr/sys/atomic.h>
#include <zephyr/sys/printk.h>

#include "app.h"

#define HEARTBEAT_PERIOD_MS 500

static const struct gpio_dt_spec button        = GPIO_DT_SPEC_GET(DT_ALIAS(sw0), gpios);
static const struct gpio_dt_spec error_led     = GPIO_DT_SPEC_GET(DT_ALIAS(led0), gpios);
static const struct gpio_dt_spec heartbeat_led = GPIO_DT_SPEC_GET(DT_ALIAS(led1), gpios);

static struct gpio_callback button_cb;
static atomic_t report_requested;

void error_led_toggle(void)
{
	gpio_pin_toggle_dt(&error_led);
}

/* GPIO callback: interrupt context. It may not use a mutex (experiment 5). */
static void button_isr(const struct device *dev, struct gpio_callback *cb, uint32_t pins)
{
	ARG_UNUSED(dev);
	ARG_UNUSED(cb);

	if (pins & BIT(button.pin)) {
		atomic_set(&report_requested, 1);
	}
}

int main(void)
{
	int ret;

	if (!gpio_is_ready_dt(&button) || !gpio_is_ready_dt(&error_led) ||
	    !gpio_is_ready_dt(&heartbeat_led)) {
		printk("ERROR: GPIO device not ready\n");
		return 0;
	}

	ret = gpio_pin_configure_dt(&error_led, GPIO_OUTPUT_INACTIVE);
	ret |= gpio_pin_configure_dt(&heartbeat_led, GPIO_OUTPUT_INACTIVE);
	ret |= gpio_pin_configure_dt(&button, GPIO_INPUT);
	ret |= gpio_pin_interrupt_configure_dt(&button, GPIO_INT_EDGE_TO_ACTIVE);
	if (ret < 0) {
		printk("ERROR: could not configure GPIO pins\n");
		return 0;
	}

	gpio_init_callback(&button_cb, button_isr, BIT(button.pin));
	gpio_add_callback(button.port, &button_cb);

	printk("\n03_mutexes on %s\n", CONFIG_BOARD);

	ownership_tour();
	sensors_start();

	int64_t next_report = k_uptime_get() + CONFIG_APP_REPORT_PERIOD_MS;

	while (1) {
		gpio_pin_toggle_dt(&heartbeat_led);
		k_msleep(HEARTBEAT_PERIOD_MS);

		if (atomic_set(&report_requested, 0) || k_uptime_get() >= next_report) {
			next_report = k_uptime_get() + CONFIG_APP_REPORT_PERIOD_MS;
			sensors_report();
		}
	}

	return 0;
}
```

## src/app.h
```c
/* 03_mutexes: interfaces between the source files. */
#ifndef APP_H_
#define APP_H_

#include <stdint.h>

/* bus.c: a simulated I2C bus shared by two sensor threads */
#define DEV_TEMP   0x48   /* temperature sensor (like a TMP102) */
#define DEV_ACCEL  0x19   /* accelerometer (like a LIS2DH) */
#define REG_TEMP   0x00
#define REG_OUT_X  0x28
#define REG_OUT_Y  0x2A
#define REG_OUT_Z  0x2C

int  bus_lock(void);                 /* 0, or -EAGAIN after CONFIG_APP_LOCK_TIMEOUT_MS */
void bus_unlock(void);
int  bus_read_reg(uint8_t dev, uint8_t reg, int16_t *value);  /* 0, -EAGAIN or -EIO */
const char *bus_lock_name(void);

/* sensors.c */
void sensors_start(void);
void sensors_report(void);

/* ownership_tour.c */
void ownership_tour(void);

/* main.c */
void error_led_toggle(void);

#endif /* APP_H_ */
```

## src/bus.c
```c
/*
 * 03_mutexes: a simulated I2C bus, and the lock that protects it
 *
 * Reading one register of an I2C device is a transaction of three steps:
 *
 *   1. START, device address + write
 *   2. register address
 *   3. repeated START, device address + read, data bytes, STOP
 *
 * Each step occupies the bus for CONFIG_APP_BUS_STEP_US (k_busy_wait, so
 * the thread really uses the CPU, as a polled driver would). If another
 * thread starts its own transaction between two steps, the transactions
 * interleave:
 *   - the thread that was interrupted reads the OTHER thread's device or
 *     register, i.e. wrong data;
 *   - the thread that started while the bus was busy collides with it.
 * The simulated devices tag every value with the address and register it
 * came from, so this model detects both cases exactly. A real bus would
 * just give you garbage.
 *
 * Zephyr's real I2C drivers lock the bus inside each i2c_transfer() call.
 * What they cannot protect is a sequence of separate calls that must not
 * be split, e.g. i2c_write() of a register address followed by
 * i2c_read(). That sequence is what this file models, and what the
 * application must lock itself.
 */

#include <zephyr/kernel.h>
#include <zephyr/sys/printk.h>

#include "app.h"

/* ------------------------------------------------------------------ */
/* The lock: chosen in prj.conf                                        */
/* ------------------------------------------------------------------ */

#if defined(CONFIG_APP_LOCK_MUTEX)
/* One mutex per bus. Unlocked at start; the owner is recorded by the kernel. */
K_MUTEX_DEFINE(bus_mutex);
#elif defined(CONFIG_APP_LOCK_SEMAPHORE)
/* The tempting alternative: a binary semaphore, initially 1 ("free"). */
K_SEM_DEFINE(bus_sem, 1, 1);
#endif

const char *bus_lock_name(void)
{
	if (IS_ENABLED(CONFIG_APP_LOCK_MUTEX)) {
		return "k_mutex";
	}
	if (IS_ENABLED(CONFIG_APP_LOCK_SEMAPHORE)) {
		return "binary k_sem";
	}
	return "none";
}

int bus_lock(void)
{
#if defined(CONFIG_APP_LOCK_MUTEX)
	/* Recursive: if this thread already owns the mutex, this only counts up. */
	return k_mutex_lock(&bus_mutex, K_MSEC(CONFIG_APP_LOCK_TIMEOUT_MS));
#elif defined(CONFIG_APP_LOCK_SEMAPHORE)
	/* Not recursive: a second take by the same thread waits for itself. */
	return k_sem_take(&bus_sem, K_MSEC(CONFIG_APP_LOCK_TIMEOUT_MS));
#else
	return 0;
#endif
}

void bus_unlock(void)
{
#if defined(CONFIG_APP_LOCK_MUTEX)
	int ret = k_mutex_unlock(&bus_mutex);

	/* Only fails if this thread is not the owner (-EPERM) or the mutex is
	 * not locked (-EINVAL): both are bugs in the caller.
	 */
	if (ret != 0) {
		printk("[bus] ERROR: k_mutex_unlock() returned %d\n", ret);
	}
#elif defined(CONFIG_APP_LOCK_SEMAPHORE)
	k_sem_give(&bus_sem);   /* never fails, even if the caller never took it */
#endif
}

/* ------------------------------------------------------------------ */
/* The simulated hardware                                              */
/* ------------------------------------------------------------------ */

static struct {
	bool busy;          /* a transaction is in progress */
	uint8_t addr;       /* device addressed by the last START */
	uint8_t reg;        /* register selected by the last register write */
} bus;

/* What a device returns: its value, tagged with where it came from. */
struct reading {
	uint8_t addr;
	uint8_t reg;
	int16_t value;
};

static struct reading sim_device_read(uint8_t addr, uint8_t reg)
{
	static int16_t wobble;  /* makes the values change a little */
	struct reading r = { .addr = addr, .reg = reg };

	wobble = (wobble + 1) % 8;

	if (addr == DEV_TEMP && reg == REG_TEMP) {
		r.value = 2350 + wobble;            /* 23.50 degC, in 0.01 degC */
	} else if (addr == DEV_ACCEL && reg == REG_OUT_X) {
		r.value = 12 + wobble;              /* mg */
	} else if (addr == DEV_ACCEL && reg == REG_OUT_Y) {
		r.value = -8 + wobble;
	} else if (addr == DEV_ACCEL && reg == REG_OUT_Z) {
		r.value = 1000 + wobble;            /* board lying flat: 1 g */
	} else {
		r.value = -1;                       /* no such register */
	}
	return r;
}

static void bus_step(void)
{
	k_busy_wait(CONFIG_APP_BUS_STEP_US);
}

/* One register read. NOT safe to run in two threads at once. */
static int bus_transaction(uint8_t dev, uint8_t reg, int16_t *value)
{
	bool collided = false;

	/* Step 1: START + address. Another transaction must not be in flight. */
	if (bus.busy) {
		collided = true;
	}
	bus.busy = true;
	bus.addr = dev;
	bus_step();

	/* Step 2: register address. */
	bus.reg = reg;
	bus_step();

	/* Step 3: repeated START + read. The device answers for whatever the
	 * bus state says NOW, which may have been changed by another thread.
	 */
	bus_step();
	struct reading r = sim_device_read(bus.addr, bus.reg);

	bus.busy = false;

	*value = r.value;
	if (collided || r.addr != dev || r.reg != reg) {
		return -EIO;
	}
	return 0;
}

/* ------------------------------------------------------------------ */
/* The public, locked API                                              */
/* ------------------------------------------------------------------ */

/*
 * Read one register as one indivisible transaction: the lock is held for
 * exactly the three bus steps, and released before the caller processes
 * the value.
 */
int bus_read_reg(uint8_t dev, uint8_t reg, int16_t *value)
{
	int ret = bus_lock();

	if (ret != 0) {
		return ret;     /* -EAGAIN: did not get the bus in time */
	}

	ret = bus_transaction(dev, reg, value);

	bus_unlock();       /* one exit point: no path can skip the unlock */
	return ret;
}
```

## src/ownership_tour.c
```c
/*
 * 03_mutexes: the ownership tour
 *
 * Runs once at startup, before the sensor threads start. It shows each
 * rule of mutex ownership as a return code, by calling the API from
 * main() and from a short-lived helper thread ("other"). Then it repeats
 * the key steps with a binary semaphore, which has no owner.
 *
 * It uses its own mutex and semaphore, not the bus lock.
 */

#include <zephyr/kernel.h>
#include <zephyr/sys/printk.h>

#include "app.h"

#if defined(CONFIG_APP_OWNERSHIP_TOUR)

K_MUTEX_DEFINE(tour_mutex);
K_SEM_DEFINE(tour_sem, 1, 1);

#define OTHER_STACK_SIZE 1024
#define OTHER_PRIORITY   1      /* more urgent than main: runs at once */

K_THREAD_STACK_DEFINE(other_stack, OTHER_STACK_SIZE);
static struct k_thread other_thread;

typedef int (*op_fn)(void);

static void other_entry(void *p1, void *p2, void *p3)
{
	op_fn op = (op_fn)p1;
	int *result = p2;

	ARG_UNUSED(p3);
	*result = op();
}

/* Run op() in another thread and return its result. */
static int in_other_thread(op_fn op)
{
	int result;

	k_thread_create(&other_thread, other_stack, K_THREAD_STACK_SIZEOF(other_stack),
			other_entry, (void *)op, &result, NULL,
			OTHER_PRIORITY, 0, K_NO_WAIT);
	k_thread_name_set(&other_thread, "other");
	k_thread_join(&other_thread, K_FOREVER);
	return result;
}

static int mutex_unlock(void)       { return k_mutex_unlock(&tour_mutex); }
static int mutex_try_lock(void)     { return k_mutex_lock(&tour_mutex, K_NO_WAIT); }
static int mutex_lock_20ms(void)    { return k_mutex_lock(&tour_mutex, K_MSEC(20)); }
static int mutex_lock_unlock(void)
{
	int ret = k_mutex_lock(&tour_mutex, K_NO_WAIT);

	if (ret == 0) {
		k_mutex_unlock(&tour_mutex);    /* never exit a thread holding a mutex */
	}
	return ret;
}
static int sem_give(void)           { k_sem_give(&tour_sem); return 0; }

static const char *code_name(int ret)
{
	switch (ret) {
	case 0:        return "0";
	case -EBUSY:   return "-EBUSY";
	case -EAGAIN:  return "-EAGAIN";
	case -EPERM:   return "-EPERM";
	case -EINVAL:  return "-EINVAL";
	default:       return "other error";
	}
}

static void show(const char *who, const char *what, int ret, const char *meaning)
{
	printk("  %-6s %-34s -> %-8s %s\n", who, what, code_name(ret), meaning);
}

void ownership_tour(void)
{
	int ret;

	printk("\n--- Ownership tour: k_mutex ---\n");

	ret = k_mutex_unlock(&tour_mutex);
	show("main", "unlock (mutex is not locked)", ret, "nothing to unlock");

	ret = k_mutex_lock(&tour_mutex, K_FOREVER);
	show("main", "lock", ret, "main is now the owner");

	ret = in_other_thread(mutex_unlock);
	show("other", "unlock", ret, "rejected: other is not the owner");

	ret = in_other_thread(mutex_try_lock);
	show("other", "lock, K_NO_WAIT", ret, "held by main");

	ret = in_other_thread(mutex_lock_20ms);
	show("other", "lock, 20 ms timeout", ret, "gave up after 20 ms");

	ret = k_mutex_lock(&tour_mutex, K_FOREVER);
	show("main", "lock again (recursive)", ret, "lock count is now 2");

	ret = k_mutex_unlock(&tour_mutex);
	show("main", "unlock", ret, "lock count 1: still locked");

	ret = in_other_thread(mutex_try_lock);
	show("other", "lock, K_NO_WAIT", ret, "still held by main");

	ret = k_mutex_unlock(&tour_mutex);
	show("main", "unlock", ret, "lock count 0: free");

	ret = in_other_thread(mutex_lock_unlock);
	show("other", "lock, K_NO_WAIT (then unlock)", ret, "free, so other gets it");

	printk("--- The same with a binary k_sem used as a lock ---\n");

	ret = k_sem_take(&tour_sem, K_FOREVER);
	show("main", "take (\"lock\")", ret, "main holds it, but the kernel does not know");

	ret = in_other_thread(sem_give);
	show("other", "give (\"unlock\")", ret, "accepted: a semaphore has no owner");

	ret = k_sem_take(&tour_sem, K_NO_WAIT);
	show("main", "take again, K_NO_WAIT", ret, "succeeds only because other gave");

	ret = k_sem_take(&tour_sem, K_MSEC(20));
	show("main", "take again (nested), 20 ms", ret, "not recursive: main waits for itself");

	k_sem_give(&tour_sem);
	printk("--- End of tour ---\n\n");
}

#else

void ownership_tour(void)
{
}

#endif /* CONFIG_APP_OWNERSHIP_TOUR */
```

## src/sensors.c
```c
/*
 * 03_mutexes: two sensor threads that share one bus
 *
 *   temp   priority 6: reads the temperature register, then sleeps 2 ms.
 *   accel  priority 4 (more urgent): every 10 ms reads X, Y and Z.
 *
 * The accelerometer must get X, Y and Z from the same moment, so it holds
 * the bus lock for the whole sample. Inside, it calls bus_read_reg(),
 * which locks the bus again. With a k_mutex this nested lock is fine
 * (recursive locking); with a semaphore it is a self-deadlock.
 */

#include <zephyr/kernel.h>
#include <zephyr/sys/printk.h>

#include "app.h"

#define STACK_SIZE      1024
#define TEMP_PRIORITY   6
#define ACCEL_PRIORITY  4
#define TEMP_PAUSE_MS   2
#define ACCEL_PERIOD_MS 10

struct sensor_stats {
	uint32_t ok;
	uint32_t bad;           /* -EIO: torn transaction, wrong or garbled data */
	uint32_t timeouts;      /* -EAGAIN: did not get the bus lock in time */
	uint32_t longest_us;    /* longest read, including waiting for the lock */
};

/*
 * Each thread writes only its own entry; main() reads them for the report.
 * Aligned 32-bit loads and stores are single instructions on the
 * Cortex-M7, so no value is ever seen half-written. (The values of one
 * entry may be from slightly different moments, which a report tolerates.)
 */
static struct sensor_stats temp_stats;
static struct sensor_stats accel_stats;

static void record(struct sensor_stats *st, int ret, uint32_t start_cycles)
{
	uint32_t us = k_cyc_to_us_floor32(k_cycle_get_32() - start_cycles);

	if (us > st->longest_us) {
		st->longest_us = us;
	}

	if (ret == 0) {
		st->ok++;
	} else if (ret == -EAGAIN) {
		st->timeouts++;
	} else {
		st->bad++;
		error_led_toggle();
	}
}

/* ------------------------------------------------------------------ */

static void temp_thread(void *p1, void *p2, void *p3)
{
	ARG_UNUSED(p1);
	ARG_UNUSED(p2);
	ARG_UNUSED(p3);

	while (1) {
		int16_t centi_degc;
		uint32_t start = k_cycle_get_32();
		int ret = bus_read_reg(DEV_TEMP, REG_TEMP, &centi_degc);

		record(&temp_stats, ret, start);

		/* Processing happens here, after the bus was released. */
		k_msleep(TEMP_PAUSE_MS);
	}
}

/* ------------------------------------------------------------------ */

static int accel_read_sample(int16_t xyz[3])
{
	static const uint8_t regs[3] = { REG_OUT_X, REG_OUT_Y, REG_OUT_Z };
	int result = 0;

	/* Outer lock: nobody may use the bus between the three reads. */
	int ret = bus_lock();

	if (ret != 0) {
		return ret;
	}

	for (int i = 0; i < 3; i++) {
		/* bus_read_reg() locks again: nested (recursive) locking. */
		ret = bus_read_reg(DEV_ACCEL, regs[i], &xyz[i]);
		if (ret != 0 && result == 0) {
			result = ret;   /* keep the first error, finish the sample */
		}
	}

#if CONFIG_APP_ACCEL_WORK_IN_LOCK_MS > 0
	/* WRONG SCOPE (experiment 4): processing while still holding the bus. */
	k_msleep(CONFIG_APP_ACCEL_WORK_IN_LOCK_MS);
#endif

	bus_unlock();
	return result;
}

static void accel_thread(void *p1, void *p2, void *p3)
{
	ARG_UNUSED(p1);
	ARG_UNUSED(p2);
	ARG_UNUSED(p3);

	while (1) {
		int16_t xyz[3];
		uint32_t start = k_cycle_get_32();
		int ret = accel_read_sample(xyz);

		record(&accel_stats, ret, start);

		k_msleep(ACCEL_PERIOD_MS);
	}
}

/* Created at boot but not started (K_FOREVER): main() starts them after the tour. */
K_THREAD_DEFINE(temp_tid, STACK_SIZE, temp_thread, NULL, NULL, NULL,
		TEMP_PRIORITY, 0, SYS_FOREVER_MS);
K_THREAD_DEFINE(accel_tid, STACK_SIZE, accel_thread, NULL, NULL, NULL,
		ACCEL_PRIORITY, 0, SYS_FOREVER_MS);

void sensors_start(void)
{
	k_thread_name_set(temp_tid, "temp");
	k_thread_name_set(accel_tid, "accel");

	printk("Sensors: temp (prio %d) reads every %d ms, accel (prio %d) every %d ms. "
	       "Bus lock: %s\n",
	       TEMP_PRIORITY, TEMP_PAUSE_MS, ACCEL_PRIORITY, ACCEL_PERIOD_MS, bus_lock_name());

	k_thread_start(temp_tid);
	k_thread_start(accel_tid);
}

static void print_stats(const char *name, const char *unit, const struct sensor_stats *st)
{
	printk("[bus]   %-5s %s ok=%u bad=%u lock timeouts=%u longest=%u us\n",
	       name, unit, st->ok, st->bad, st->timeouts, st->longest_us);
}

void sensors_report(void)
{
	printk("[bus] t=%u ms, lock: %s\n", (uint32_t)k_uptime_get(), bus_lock_name());
	print_stats("temp", "reads  ", &temp_stats);
	print_stats("accel", "samples", &accel_stats);
}
```
