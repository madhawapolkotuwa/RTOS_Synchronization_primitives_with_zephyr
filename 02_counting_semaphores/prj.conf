## CMakeLists.txt
```
cmake_minimum_required(VERSION 3.20.0)

find_package(Zephyr REQUIRED HINTS $ENV{ZEPHYR_BASE})
project(counting_semaphores)

target_sources(app PRIVATE src/main.c)
# Exactly one demo is compiled in, chosen in prj.conf (see Kconfig).
target_sources_ifdef(CONFIG_APP_DEMO_EVENTS app PRIVATE src/event_counter.c)
target_sources_ifdef(CONFIG_APP_DEMO_POOL   app PRIVATE src/buffer_pool.c)
```

## Kconfig
```
# Application options for 02_counting_semaphores.
# Change them in prj.conf; no code edits are needed for most experiments.

mainmenu "02_counting_semaphores"

choice APP_DEMO
	prompt "Which demo to build"
	default APP_DEMO_EVENTS

config APP_DEMO_EVENTS
	bool "Part A: count bursty events without losing any"

config APP_DEMO_POOL
	bool "Part B: a pool of identical buffers with back-pressure"

endchoice

config APP_REPORT_PERIOD_MS
	int "Period of the statistics report printed by main (ms)"
	default 2000
	help
	  main() runs at the lowest priority and prints a summary at this
	  period. Part B uses it; Part A prints one line per event instead.

# --- Part A: used only when APP_DEMO_EVENTS is selected ---

config APP_EVENT_SEM_LIMIT
	int "Limit of the counting semaphore"
	default 10
	range 1 1000
	help
	  The most events the semaphore can hold. An event given when the
	  count is already at the limit is lost. 1 makes it a binary
	  semaphore, as in tutorial 01.

config APP_PROCESSING_MS
	int "Time the handler thread spends on each event (ms)"
	default 100

config APP_BURST_SIZE
	int "Events in each burst"
	default 8
	range 1 1000

config APP_BURST_GAP_MS
	int "Time between two events of a burst (ms)"
	default 10
	range 1 10000

config APP_BURST_PERIOD_MS
	int "Time from the start of one burst to the start of the next (ms, 0 = no bursts)"
	default 3000
	help
	  A k_timer generates the bursts from interrupt context. Use a
	  multiple of APP_BURST_GAP_MS that is longer than one burst.
	  0 turns the timer off: then only the button raises events.

config APP_FLUSH_THRESHOLD
	int "Discard the backlog with k_sem_reset() when it reaches this size (0 = never)"
	default 0
	help
	  A policy for when old events are worth less than new ones: if the
	  handler finds this many events pending, it throws them all away
	  and counts them as discarded.

# --- Part B: used only when APP_DEMO_POOL is selected ---

config APP_POOL_SIZE
	int "Number of buffers in the pool"
	default 4
	range 1 32

config APP_SENDER_PERIOD_MS
	int "Pause of each sender thread after it has queued a message (ms)"
	default 200

config APP_TX_TIME_MS
	int "Time one simulated transmission keeps a buffer busy (ms)"
	default 300

config APP_ALLOC_TIMEOUT_MS
	int "How long a sender waits for a free buffer (ms, 0 = do not wait)"
	default 1000
	help
	  When it expires the sender gives up on that message and counts
	  it as failed.

source "Kconfig.zephyr"
```

## prj.conf
```kconfig
# --- Drivers ---
CONFIG_GPIO=y

# --- Scheduling ---
# main() blinks a heartbeat LED and prints reports: least urgent priority.
# Lower number = higher priority. Part A's handler runs at 2, Part B's senders at 5.
CONFIG_MAIN_THREAD_PRIORITY=7
CONFIG_THREAD_NAME=y

# --- Debugging ---
CONFIG_ASSERT=y

# --- Which demo: uncomment exactly one line ---
CONFIG_APP_DEMO_EVENTS=y
# CONFIG_APP_DEMO_POOL=y

# --- Part A options (see Kconfig) ---
CONFIG_APP_EVENT_SEM_LIMIT=10
CONFIG_APP_PROCESSING_MS=100
CONFIG_APP_BURST_SIZE=8
CONFIG_APP_BURST_GAP_MS=10
CONFIG_APP_BURST_PERIOD_MS=3000
CONFIG_APP_FLUSH_THRESHOLD=0

# --- Part B options (see Kconfig) ---
CONFIG_APP_POOL_SIZE=4
CONFIG_APP_SENDER_PERIOD_MS=200
CONFIG_APP_TX_TIME_MS=300
CONFIG_APP_ALLOC_TIMEOUT_MS=1000
CONFIG_APP_REPORT_PERIOD_MS=2000
```

## src/main.c
```c
/*
 * 02_counting_semaphores: common part
 * Board: STM32F769I-DISCO, Zephyr RTOS
 *
 * This file owns the hardware: the blue USER button, the red event LED
 * (LD1) and the green heartbeat LED (LD2). It sets them up, forwards
 * button interrupts to the demo, and then runs at the lowest priority,
 * blinking the heartbeat and calling demo_report().
 *
 * The semaphore work is in the demo file that prj.conf selects:
 *   Part A  src/event_counter.c  count bursty events without loss
 *   Part B  src/buffer_pool.c    a pool of identical buffers with back-pressure
 *
 * Theory: resources/webpages/05_semaphores.html
 */

#include <zephyr/kernel.h>
#include <zephyr/drivers/gpio.h>
#include <zephyr/sys/printk.h>

#include "demo.h"

#define HEARTBEAT_PERIOD_MS 500

static const struct gpio_dt_spec button        = GPIO_DT_SPEC_GET(DT_ALIAS(sw0), gpios);
static const struct gpio_dt_spec event_led     = GPIO_DT_SPEC_GET(DT_ALIAS(led0), gpios);
static const struct gpio_dt_spec heartbeat_led = GPIO_DT_SPEC_GET(DT_ALIAS(led1), gpios);

static struct gpio_callback button_cb;

void event_led_toggle(void)
{
	gpio_pin_toggle_dt(&event_led);
}

void event_led_set(bool on)
{
	gpio_pin_set_dt(&event_led, on ? 1 : 0);
}

/* GPIO callback: on the STM32 this runs inside the EXTI interrupt. */
static void button_isr(const struct device *dev, struct gpio_callback *cb, uint32_t pins)
{
	ARG_UNUSED(dev);
	ARG_UNUSED(cb);

	if (pins & BIT(button.pin)) {
		demo_button_pressed();
	}
}

int main(void)
{
	int ret;

	if (!gpio_is_ready_dt(&button) || !gpio_is_ready_dt(&event_led) ||
	    !gpio_is_ready_dt(&heartbeat_led)) {
		printk("ERROR: GPIO device not ready\n");
		return 0;
	}

	ret = gpio_pin_configure_dt(&event_led, GPIO_OUTPUT_INACTIVE);
	ret |= gpio_pin_configure_dt(&heartbeat_led, GPIO_OUTPUT_INACTIVE);
	ret |= gpio_pin_configure_dt(&button, GPIO_INPUT);
	if (ret < 0) {
		printk("ERROR: could not configure GPIO pins\n");
		return 0;
	}

	ret = gpio_pin_interrupt_configure_dt(&button, GPIO_INT_EDGE_TO_ACTIVE);
	if (ret < 0) {
		printk("ERROR: could not configure button interrupt (%d)\n", ret);
		return 0;
	}

	gpio_init_callback(&button_cb, button_isr, BIT(button.pin));
	gpio_add_callback(button.port, &button_cb);

	printk("\n02_counting_semaphores on %s\n", CONFIG_BOARD);
	demo_start();

	/* Heartbeat and periodic report, at the lowest priority. */
	int64_t next_report = k_uptime_get() + CONFIG_APP_REPORT_PERIOD_MS;

	while (1) {
		gpio_pin_toggle_dt(&heartbeat_led);
		k_msleep(HEARTBEAT_PERIOD_MS);

		if (k_uptime_get() >= next_report) {
			next_report += CONFIG_APP_REPORT_PERIOD_MS;
			demo_report();
		}
	}

	return 0;
}
```

## src/buffer_pool.c
```c
/*
 * 02_counting_semaphores, Part B: a pool of identical buffers with back-pressure
 *
 * POOL_SIZE transmit buffers are shared by three sender threads and the
 * button ISR. A buffer is busy from the moment a sender takes it until its
 * simulated transmission completes TX_TIME_MS later. A k_timer per buffer
 * stands in for the "DMA complete" interrupt, which returns the buffer.
 *
 * Two structures manage the pool, as in Lesson 05, worked example 2:
 *   free_bufs  counting semaphore, initial POOL_SIZE, limit POOL_SIZE.
 *              It counts the free buffers, and makes a sender wait when
 *              there are none. That wait is the back-pressure.
 *   busy_map   one atomic bit per buffer. It records WHICH buffers are
 *              free. The semaphore cannot tell you that.
 *
 * Senders are threads, so they may wait for a buffer. The button ISR may
 * not wait: it uses K_NO_WAIT and drops its message when the pool is empty.
 */

#include <zephyr/kernel.h>
#include <zephyr/sys/atomic.h>
#include <zephyr/sys/printk.h>

#include "demo.h"

#define POOL_SIZE         CONFIG_APP_POOL_SIZE
#define NUM_SENDERS       3
#define SENDER_STACK_SIZE 1024
#define SENDER_PRIORITY   5     /* all equal: they share the pool fairly */
#define MSG_MAX           32

/* ------------------------------------------------------------------ */
/* The pool                                                            */
/* ------------------------------------------------------------------ */

struct tx_buffer {
	struct k_timer tx_done;     /* simulated "transmission complete" interrupt */
	char data[MSG_MAX];
};

static struct tx_buffer pool[POOL_SIZE];

/* Counts free buffers. Initial count = limit = POOL_SIZE: all free at start. */
K_SEM_DEFINE(free_bufs, POOL_SIZE, POOL_SIZE);

/* Bit i set = buffer i in use. ATOMIC_DEFINE starts all-zero: all free. */
static ATOMIC_DEFINE(busy_map, POOL_SIZE);

/* Statistics. Written from several threads and ISRs, hence atomic. */
static atomic_t free_low_water = ATOMIC_INIT(POOL_SIZE);
static atomic_t tx_completed;
static atomic_t isr_sent;
static atomic_t isr_dropped;
static atomic_t pool_errors;

static void record_low_water(atomic_val_t free_now)
{
	atomic_val_t old;

	do {
		old = atomic_get(&free_low_water);
		if (free_now >= old) {
			return;
		}
	} while (!atomic_cas(&free_low_water, old, free_now));
}

/* Red LED on while the pool is empty, i.e. while senders feel back-pressure. */
static void show_pool_state(void)
{
	/* Masked so that the LED always ends up matching the latest count. */
	unsigned int key = irq_lock();

	event_led_set(k_sem_count_get(&free_bufs) == 0);
	irq_unlock(key);
}

/*
 * Get a free buffer, waiting up to `timeout` for one.
 * From an ISR, `timeout` must be K_NO_WAIT.
 * Returns NULL if no buffer became free in time.
 */
static struct tx_buffer *pool_alloc(k_timeout_t timeout)
{
	/* Step 1: reserve one unit. Blocks while all buffers are busy. */
	if (k_sem_take(&free_bufs, timeout) != 0) {
		return NULL;
	}

	record_low_water(k_sem_count_get(&free_bufs));
	show_pool_state();

	/*
	 * Step 2: find which buffer. The semaphore guarantees that at most
	 * POOL_SIZE holders exist, so at least one bit is clear. Two callers
	 * may scan at once: atomic_test_and_set_bit() lets only one of them
	 * claim each bit.
	 */
	for (int i = 0; i < POOL_SIZE; i++) {
		if (!atomic_test_and_set_bit(busy_map, i)) {
			return &pool[i];
		}
	}

	/* Unreachable while the semaphore and the map agree. */
	atomic_inc(&pool_errors);
	printk("[pool] ERROR: the semaphore granted a buffer but none is free\n");
	return NULL;
}

/* Return a buffer to the pool. Safe from ISRs and threads. */
static void pool_free(struct tx_buffer *buf)
{
	int index = buf - pool;

	/*
	 * Order matters: mark the buffer free BEFORE giving the semaphore.
	 * The other way round, a woken sender could scan the map before the
	 * bit is cleared and find nothing.
	 */
	if (!atomic_test_and_clear_bit(busy_map, index)) {
		/* It was already free: a double free. Do not give twice. */
		atomic_inc(&pool_errors);
		return;
	}

	k_sem_give(&free_bufs);
	show_pool_state();
}

/* Timer expiry = "transmission complete" interrupt. */
static void tx_done_isr(struct k_timer *timer)
{
	struct tx_buffer *buf = CONTAINER_OF(timer, struct tx_buffer, tx_done);

	atomic_inc(&tx_completed);
	pool_free(buf);
}

/* Hand a filled buffer to the (simulated) transmitter. */
static void transmit(struct tx_buffer *buf)
{
	k_timer_start(&buf->tx_done, K_MSEC(CONFIG_APP_TX_TIME_MS), K_NO_WAIT);
}

/* ------------------------------------------------------------------ */
/* Producers                                                           */
/* ------------------------------------------------------------------ */

struct sender_stats {
	uint32_t sent;
	uint32_t failed;        /* no buffer within CONFIG_APP_ALLOC_TIMEOUT_MS */
	uint32_t max_wait_ms;
};

/*
 * Each sender writes only its own entry; main() reads them for the report.
 * 32-bit loads and stores are single instructions on the Cortex-M7, so
 * main() never sees a half-written value. The three values of one entry
 * may be from slightly different moments, which is fine for a report.
 */
static struct sender_stats stats[NUM_SENDERS];

K_THREAD_STACK_ARRAY_DEFINE(sender_stacks, NUM_SENDERS, SENDER_STACK_SIZE);
static struct k_thread sender_threads[NUM_SENDERS];

static void sender_thread(void *p1, void *p2, void *p3)
{
	int id = (int)(uintptr_t)p1;
	struct sender_stats *st = &stats[id];
	uint32_t seq = 0;

	ARG_UNUSED(p2);
	ARG_UNUSED(p3);

	while (1) {
		int64_t start = k_uptime_get();
		struct tx_buffer *buf = pool_alloc(K_MSEC(CONFIG_APP_ALLOC_TIMEOUT_MS));
		uint32_t waited = (uint32_t)(k_uptime_get() - start);

		if (waited > st->max_wait_ms) {
			st->max_wait_ms = waited;
		}

		if (buf == NULL) {
			st->failed++;           /* the message is dropped */
		} else {
			snprintk(buf->data, sizeof(buf->data), "sender%d #%u", id, seq);
			transmit(buf);
			st->sent++;
		}
		seq++;

		k_msleep(CONFIG_APP_SENDER_PERIOD_MS);
	}
}

/* The button ISR is a fourth producer. It may not block. */
void demo_button_pressed(void)
{
	struct tx_buffer *buf = pool_alloc(K_NO_WAIT);

	if (buf == NULL) {
		atomic_inc(&isr_dropped);
		return;
	}

	snprintk(buf->data, sizeof(buf->data), "button");
	transmit(buf);
	atomic_inc(&isr_sent);
}

/* ------------------------------------------------------------------ */
/* Called by main.c                                                    */
/* ------------------------------------------------------------------ */

void demo_start(void)
{
	printk("Part B: buffer pool. %d buffers, %d senders, send every %d ms, "
	       "transmit takes %d ms\n",
	       POOL_SIZE, NUM_SENDERS, CONFIG_APP_SENDER_PERIOD_MS, CONFIG_APP_TX_TIME_MS);

	for (int i = 0; i < POOL_SIZE; i++) {
		k_timer_init(&pool[i].tx_done, tx_done_isr, NULL);
	}

	for (int i = 0; i < NUM_SENDERS; i++) {
		char name[] = "sender0";

		name[6] = (char)('0' + i);
		k_thread_create(&sender_threads[i], sender_stacks[i],
				K_THREAD_STACK_SIZEOF(sender_stacks[i]), sender_thread,
				(void *)(uintptr_t)i, NULL, NULL, SENDER_PRIORITY, 0, K_NO_WAIT);
		k_thread_name_set(&sender_threads[i], name);
	}
}

void demo_report(void)
{
	static uint32_t last_completed;
	uint32_t completed = (uint32_t)atomic_get(&tx_completed);

	printk("[pool] t=%u ms  transmitted=%u (+%u)  free now=%u lowest=%d  "
	       "button sent=%d dropped=%d  errors=%d\n",
	       (uint32_t)k_uptime_get(), completed, completed - last_completed,
	       k_sem_count_get(&free_bufs), (int)atomic_get(&free_low_water),
	       (int)atomic_get(&isr_sent), (int)atomic_get(&isr_dropped),
	       (int)atomic_get(&pool_errors));
	last_completed = completed;

	for (int i = 0; i < NUM_SENDERS; i++) {
		printk("[pool]   sender%d sent=%u failed=%u longest wait=%u ms\n",
		       i, stats[i].sent, stats[i].failed, stats[i].max_wait_ms);
	}
}
```

## src/demo.h
```c
/*
 * The interface between main.c (hardware, heartbeat, reporting) and the
 * demo that is compiled in: event_counter.c (Part A) or buffer_pool.c
 * (Part B). Exactly one of them is built, selected in prj.conf.
 */
#ifndef DEMO_H_
#define DEMO_H_

#include <stdbool.h>

/* Implemented by the demo. */
void demo_start(void);           /* once, from main(), after the GPIO setup */
void demo_button_pressed(void);  /* from the button ISR: interrupt context */
void demo_report(void);          /* every CONFIG_APP_REPORT_PERIOD_MS, from main() */

/* Implemented by main.c. Both are safe to call from an ISR. */
void event_led_toggle(void);
void event_led_set(bool on);

#endif /* DEMO_H_ */
```

## src/event_counter.c
```c
/*
 * 02_counting_semaphores, Part A: count bursty events without losing any
 *
 * A k_timer produces bursts of events from interrupt context: BURST_SIZE
 * events, BURST_GAP_MS apart, every BURST_PERIOD_MS. The blue button adds
 * one event per press (and one per contact bounce). Each event gives a
 * counting semaphore. A handler thread takes it once per event and then
 * spends PROCESSING_MS on that event.
 *
 * During a burst events arrive faster than the handler can process them.
 * The semaphore stores the backlog, up to its limit. Between bursts the
 * handler catches up. If the limit is at least the largest backlog, no
 * event is lost.
 *
 * The ISR counts lost events exactly: an event is lost when the count is
 * already at the limit at the moment of the give.
 */

#include <zephyr/kernel.h>
#include <zephyr/sys/printk.h>

#include "demo.h"

#define HANDLER_STACK_SIZE 1024
#define HANDLER_PRIORITY   2

#define SEM_LIMIT     CONFIG_APP_EVENT_SEM_LIMIT
#define BURST_SIZE    CONFIG_APP_BURST_SIZE
#define BURST_GAP_MS  CONFIG_APP_BURST_GAP_MS
#define BURST_PERIOD  CONFIG_APP_BURST_PERIOD_MS

#if BURST_PERIOD > 0
BUILD_ASSERT(BURST_PERIOD % BURST_GAP_MS == 0,
	     "CONFIG_APP_BURST_PERIOD_MS must be a multiple of CONFIG_APP_BURST_GAP_MS");
BUILD_ASSERT(BURST_PERIOD / BURST_GAP_MS >= BURST_SIZE,
	     "a burst must fit inside one CONFIG_APP_BURST_PERIOD_MS");
#endif

/*
 * The counting semaphore.
 *   initial count 0:      no event has happened yet.
 *   limit SEM_LIMIT > 1:  up to SEM_LIMIT events can wait to be handled.
 */
K_SEM_DEFINE(event_sem, 0, SEM_LIMIT);

/*
 * Counters written in interrupt context. They are only read or written
 * with interrupts masked (irq_lock), so plain integers are enough: the
 * lock makes "read the count, give, update the counters" one indivisible
 * step, even if the button ISR and the timer ISR preempt each other.
 */
static uint32_t events_raised;
static uint32_t events_lost;        /* given while the count was at the limit */
static uint32_t events_discarded;   /* thrown away by k_sem_reset() */
static uint32_t peak_pending;       /* highest count ever reached: the backlog */

/* Only the handler thread touches this one. */
static uint32_t events_handled;

/* ------------------------------------------------------------------ */
/* Interrupt context                                                   */
/* ------------------------------------------------------------------ */

static void signal_event(void)
{
	unsigned int key = irq_lock();

	events_raised++;
	if (k_sem_count_get(&event_sem) == SEM_LIMIT) {
		events_lost++;          /* the give below will have no effect */
	}

	k_sem_give(&event_sem);     /* ISR-safe; saturates at SEM_LIMIT */

	uint32_t count = k_sem_count_get(&event_sem);

	if (count > peak_pending) {
		peak_pending = count;
	}

	irq_unlock(key);
}

void demo_button_pressed(void)
{
	signal_event();
}

#if BURST_PERIOD > 0
/*
 * Runs every BURST_GAP_MS. The first BURST_SIZE expiries of every
 * BURST_PERIOD produce an event; the rest are silent.
 */
static void burst_timer_expiry(struct k_timer *timer)
{
	static uint32_t tick;   /* only this ISR uses it */

	ARG_UNUSED(timer);

	if (tick < BURST_SIZE) {
		signal_event();
	}
	tick = (tick + 1) % (BURST_PERIOD / BURST_GAP_MS);
}

K_TIMER_DEFINE(burst_timer, burst_timer_expiry, NULL);
#endif

/* ------------------------------------------------------------------ */
/* Thread context                                                      */
/* ------------------------------------------------------------------ */

static void handle_one_event(void)
{
	uint32_t raised, lost, discarded, peak, pending;
	unsigned int key;

	events_handled++;
	event_led_toggle();

	/* A consistent snapshot: no ISR can run between these reads. */
	key = irq_lock();
	raised    = events_raised;
	lost      = events_lost;
	discarded = events_discarded;
	peak      = peak_pending;
	pending   = k_sem_count_get(&event_sem);
	irq_unlock(key);

	/* Every raised event is in exactly one of these four places. */
	bool balanced = (raised == events_handled + pending + lost + discarded);

	printk("[handler] raised=%u handled=%u pending=%u lost=%u discarded=%u peak=%u%s\n",
	       raised, events_handled, pending, lost, discarded, peak,
	       balanced ? "" : "  <-- counters do not add up");

#if CONFIG_APP_FLUSH_THRESHOLD > 0
	/*
	 * Drop policy: when the backlog gets this large, old events are
	 * stale. k_sem_reset() sets the count to 0 in one call. It does not
	 * return the old count, so read it first, with interrupts masked so
	 * that no give can slip in between the read and the reset.
	 */
	if (pending >= CONFIG_APP_FLUSH_THRESHOLD) {
		uint32_t dropped;

		key = irq_lock();
		dropped = k_sem_count_get(&event_sem);
		k_sem_reset(&event_sem);
		events_discarded += dropped;
		irq_unlock(key);

		printk("[handler] backlog reached %d: k_sem_reset() discarded %u events\n",
		       CONFIG_APP_FLUSH_THRESHOLD, dropped);
	}
#endif
}

static void handler_thread(void *p1, void *p2, void *p3)
{
	ARG_UNUSED(p1);
	ARG_UNUSED(p2);
	ARG_UNUSED(p3);

	while (1) {
		/* One take per event. Returns at once while events are pending. */
		k_sem_take(&event_sem, K_FOREVER);

		handle_one_event();

		/* Simulated work. Events raised meanwhile wait in the semaphore. */
		k_msleep(CONFIG_APP_PROCESSING_MS);
	}
}

K_THREAD_DEFINE(handler_tid, HANDLER_STACK_SIZE, handler_thread, NULL, NULL, NULL,
		HANDLER_PRIORITY, 0, 0);

/* ------------------------------------------------------------------ */
/* Called by main.c                                                    */
/* ------------------------------------------------------------------ */

void demo_start(void)
{
	k_thread_name_set(handler_tid, "handler");

	printk("Part A: counting events. Semaphore limit %d, processing %d ms per event\n",
	       SEM_LIMIT, CONFIG_APP_PROCESSING_MS);

#if BURST_PERIOD > 0
	printk("Bursts: %d events, %d ms apart, every %d ms\n",
	       BURST_SIZE, BURST_GAP_MS, BURST_PERIOD);
	k_timer_start(&burst_timer, K_MSEC(BURST_GAP_MS), K_MSEC(BURST_GAP_MS));
#else
	printk("Burst timer off. Press the blue USER button.\n");
#endif
}

void demo_report(void)
{
	/* Part A prints one line per handled event instead. */
}
```
