## CMakeLists.txt
```
cmake_minimum_required(VERSION 3.20.0)

find_package(Zephyr REQUIRED HINTS $ENV{ZEPHYR_BASE})
project(task_notifications)

target_sources(app PRIVATE src/main.c)
# Exactly one demo is compiled in, chosen in prj.conf (see Kconfig).
target_sources_ifdef(CONFIG_APP_DEMO_DRIVER app PRIVATE src/dma_driver.c)
target_sources_ifdef(CONFIG_APP_DEMO_BENCH  app PRIVATE src/signal_bench.c)
```

## Kconfig
```
# Application options for 05_task_notifications.
# Change them in prj.conf; no code edits are needed for the experiments.

mainmenu "05_task_notifications"

choice APP_DEMO
	prompt "Which demo to build"
	default APP_DEMO_DRIVER

config APP_DEMO_DRIVER
	bool "Part A: a driver thread waits for its own completion ISR"

config APP_DEMO_BENCH
	bool "Part B: one ISR signals four receivers, one per mechanism"
	select EVENTS
	select POLL

endchoice

config APP_REPORT_PERIOD_MS
	int "Period of the statistics report printed by main (ms)"
	default 2000

config APP_DEBOUNCE_MS
	int "Ignore button edges closer than this to the last accepted one (ms, 0 = off)"
	default 50

# --- Part A: used only when APP_DEMO_DRIVER is selected ---

choice APP_NOTIFY
	prompt "Part A: how the completion ISR signals the driver thread"
	default APP_NOTIFY_SEM

config APP_NOTIFY_SEM
	bool "A binary k_sem that only the driver takes"

config APP_NOTIFY_EVENT
	bool "A k_event that only the driver waits on (DONE and ERROR bits)"
	select EVENTS

config APP_NOTIFY_POLL_SIGNAL
	bool "A k_poll_signal raised with the status as its result, k_poll() to wait"
	select POLL

config APP_NOTIFY_WAKEUP
	bool "k_wakeup() of the driver thread, which waits in k_sleep()"

endchoice

config APP_TRANSFER_PERIOD_MS
	int "A new transfer starts every ... ms"
	default 100
	range 10 10000

config APP_DMA_TIME_MS
	int "Time from the start of a transfer to its completion interrupt (ms)"
	default 5
	range 1 10000
	help
	  Keep it below APP_TRANSFER_PERIOD_MS, so that one transfer has
	  completed before the next one starts.

config APP_DMA_TIMEOUT_MS
	int "How long the driver waits for the completion (ms)"
	default 20
	range 1 10000

config APP_SETUP_US
	int "Busy work the driver does after starting a transfer, before it waits (us)"
	default 0
	range 0 50000
	help
	  Experiment A2. If this is longer than the DMA time, the completion
	  arrives before the driver waits for it.

config APP_ERROR_EVERY
	int "Every Nth transfer completes with an error (0 = never)"
	default 10

config APP_RESET_BEFORE_START
	bool "Discard a leftover signal before starting each transfer"
	default y
	help
	  Experiment A4 turns this off. A completion that arrives after the
	  driver gave up on it is then taken for the next transfer's one.

# --- Part B: used only when APP_DEMO_BENCH is selected ---

config APP_BENCH_PERIOD_MS
	int "A round of signals starts every ... ms"
	default 500
	range 100 10000

config APP_BENCH_BURST
	int "Signals sent back to back at the start of each round"
	default 2
	range 1 10

config APP_BENCH_LATE_MS
	int "One more signal this long after the burst (ms, 0 = none)"
	default 10

config APP_BENCH_HANDLE_MS
	int "Time each receiver spends on one wake-up (ms)"
	default 50
	range 1 1000

source "Kconfig.zephyr"
```

## prj.conf
```kconfig
# --- Kernel objects ---
# Nothing to enable by hand: Kconfig selects CONFIG_EVENTS for the k_event
# mechanism and CONFIG_POLL for the k_poll_signal one (Part B selects both).
# k_sem and k_wakeup() are always available.

# --- Drivers ---
CONFIG_GPIO=y

# --- Scheduling ---
# main() blinks a heartbeat LED and prints reports: least urgent priority.
# Lower number = higher priority.
#   Part A: driver 2.
#   Part B: the four receivers 3.
CONFIG_MAIN_THREAD_PRIORITY=7
CONFIG_THREAD_NAME=y

# --- Debugging ---
CONFIG_ASSERT=y

# --- Which demo: uncomment exactly one line ---
CONFIG_APP_DEMO_DRIVER=y
# CONFIG_APP_DEMO_BENCH=y

# --- Common options (see Kconfig) ---
CONFIG_APP_REPORT_PERIOD_MS=2000
CONFIG_APP_DEBOUNCE_MS=50

# --- Part A: the notification mechanism, uncomment exactly one line ---
CONFIG_APP_NOTIFY_SEM=y
# CONFIG_APP_NOTIFY_EVENT=y
# CONFIG_APP_NOTIFY_POLL_SIGNAL=y
# CONFIG_APP_NOTIFY_WAKEUP=y

# --- Part A options ---
CONFIG_APP_TRANSFER_PERIOD_MS=100
CONFIG_APP_DMA_TIME_MS=5
CONFIG_APP_DMA_TIMEOUT_MS=20
CONFIG_APP_ERROR_EVERY=10
# Experiment A2: CONFIG_APP_SETUP_US=3000 and CONFIG_APP_DMA_TIME_MS=1
CONFIG_APP_SETUP_US=0
# Experiment A4: uncomment to stop discarding leftover signals.
# CONFIG_APP_RESET_BEFORE_START=n

# --- Part B options ---
CONFIG_APP_BENCH_PERIOD_MS=500
CONFIG_APP_BENCH_BURST=2
CONFIG_APP_BENCH_LATE_MS=10
CONFIG_APP_BENCH_HANDLE_MS=50
```

## src/main.c
```c
/*
 * 05_task_notifications: common part
 * Board: STM32F769I-DISCO, Zephyr RTOS
 *
 * This file owns the hardware: the blue USER button, the red event LED
 * (LD1) and the green heartbeat LED (LD2). It sets them up, debounces the
 * button and forwards presses to the demo, and then runs at the lowest
 * priority, blinking the heartbeat and calling demo_report().
 *
 * The signalling work is in the demo file that prj.conf selects:
 *   Part A  src/dma_driver.c    a driver thread waits for its completion ISR
 *   Part B  src/signal_bench.c  four mechanisms side by side
 *
 * Theory: resources/webpages/07_event_groups_and_notifications.html
 */

#include <zephyr/kernel.h>
#include <zephyr/drivers/gpio.h>
#include <zephyr/sys/printk.h>

#include "demo.h"

#define HEARTBEAT_PERIOD_MS 500

static const struct gpio_dt_spec button        = GPIO_DT_SPEC_GET(DT_ALIAS(sw0), gpios);
static const struct gpio_dt_spec event_led     = GPIO_DT_SPEC_GET(DT_ALIAS(led0), gpios);
static const struct gpio_dt_spec heartbeat_led = GPIO_DT_SPEC_GET(DT_ALIAS(led1), gpios);

static struct gpio_callback button_cb;

void event_led_toggle(void)
{
	gpio_pin_toggle_dt(&event_led);
}

void event_led_set(bool on)
{
	gpio_pin_set_dt(&event_led, on ? 1 : 0);
}

/* GPIO callback: on the STM32 this runs inside the EXTI interrupt. */
static void button_isr(const struct device *dev, struct gpio_callback *cb, uint32_t pins)
{
	ARG_UNUSED(dev);
	ARG_UNUSED(cb);

	if (!(pins & BIT(button.pin))) {
		return;
	}

#if CONFIG_APP_DEBOUNCE_MS > 0
	/*
	 * Contact bounce produces several edges per press. Accept an edge
	 * only if the last accepted one is at least DEBOUNCE_MS old. Only
	 * this ISR uses last_accepted, so no lock is needed.
	 */
	static int64_t last_accepted = -CONFIG_APP_DEBOUNCE_MS;
	int64_t now = k_uptime_get();

	if (now - last_accepted < CONFIG_APP_DEBOUNCE_MS) {
		return;
	}
	last_accepted = now;
#endif

	demo_button_pressed();
}

int main(void)
{
	int ret;

	if (!gpio_is_ready_dt(&button) || !gpio_is_ready_dt(&event_led) ||
	    !gpio_is_ready_dt(&heartbeat_led)) {
		printk("ERROR: GPIO device not ready\n");
		return 0;
	}

	ret = gpio_pin_configure_dt(&event_led, GPIO_OUTPUT_INACTIVE);
	ret |= gpio_pin_configure_dt(&heartbeat_led, GPIO_OUTPUT_INACTIVE);
	ret |= gpio_pin_configure_dt(&button, GPIO_INPUT);
	if (ret < 0) {
		printk("ERROR: could not configure GPIO pins\n");
		return 0;
	}

	ret = gpio_pin_interrupt_configure_dt(&button, GPIO_INT_EDGE_TO_ACTIVE);
	if (ret < 0) {
		printk("ERROR: could not configure button interrupt (%d)\n", ret);
		return 0;
	}

	gpio_init_callback(&button_cb, button_isr, BIT(button.pin));
	gpio_add_callback(button.port, &button_cb);

	printk("\n05_task_notifications on %s\n", CONFIG_BOARD);
	demo_start();

	/* Heartbeat and periodic report, at the lowest priority. */
	int64_t next_report = k_uptime_get() + CONFIG_APP_REPORT_PERIOD_MS;

	while (1) {
		gpio_pin_toggle_dt(&heartbeat_led);
		k_msleep(HEARTBEAT_PERIOD_MS);

		if (k_uptime_get() >= next_report) {
			next_report += CONFIG_APP_REPORT_PERIOD_MS;
			demo_report();
		}
	}

	return 0;
}
```

## src/demo.h
```c
/*
 * The interface between main.c (hardware, heartbeat, reporting) and the
 * demo that is compiled in: dma_driver.c (Part A) or signal_bench.c
 * (Part B). Exactly one of them is built, selected in prj.conf.
 */
#ifndef DEMO_H_
#define DEMO_H_

#include <stdbool.h>

/* Implemented by the demo. */
void demo_start(void);           /* once, from main(), after the GPIO setup */
void demo_button_pressed(void);  /* from the button ISR (debounced): interrupt context */
void demo_report(void);          /* every CONFIG_APP_REPORT_PERIOD_MS, from main() */

/* Implemented by main.c. Both are safe to call from an ISR. */
void event_led_toggle(void);
void event_led_set(bool on);

#endif /* DEMO_H_ */
```

## src/dma_driver.c
```c
/*
 * 05_task_notifications, Part A: a driver thread and its completion ISR
 *
 * Lesson 07, worked example 2: a driver starts a transfer and waits for
 * the "DMA complete" interrupt, with a timeout. Only the driver ever waits
 * for that interrupt, so the signal is one-to-one: a task notification in
 * FreeRTOS terms. Zephyr has no notification API, so this file implements
 * the signal in one of four ways, chosen in prj.conf:
 *
 *   APP_NOTIFY_SEM          a binary k_sem that only the driver takes
 *   APP_NOTIFY_EVENT        a k_event that only the driver waits on
 *   APP_NOTIFY_POLL_SIGNAL  a k_poll_signal, which also carries an int
 *   APP_NOTIFY_WAKEUP       k_wakeup() of the driver, which waits in k_sleep()
 *
 * The rest of the file does not change between them. The "DMA" is a
 * one-shot k_timer, whose expiry function runs in interrupt context, like
 * a real completion ISR. It stamps the cycle counter just before it
 * signals, and the driver stamps it again when it wakes: the difference
 * is the cost of the mechanism, as seen by the driver.
 *
 * Kconfig switches create the classic failures (experiments A2 to A4).
 */

#include <errno.h>
#include <zephyr/kernel.h>
#include <zephyr/sys/atomic.h>
#include <zephyr/sys/printk.h>
#include <zephyr/sys/util.h>

#include "demo.h"

#define STACK_SIZE       1024
#define DRIVER_PRIORITY  2

/* The button makes the next transfer complete this long after its timeout. */
#define LATE_EXTRA_MS    10

/* Forward declaration: the k_wakeup() mechanism needs the thread ID. */
static void driver_thread(void *p1, void *p2, void *p3);
K_THREAD_DEFINE(driver_tid, STACK_SIZE, driver_thread, NULL, NULL, NULL,
		DRIVER_PRIORITY, 0, SYS_FOREVER_MS);

static int64_t t0;

static uint32_t now_ms(void)
{
	return (uint32_t)(k_uptime_get() - t0);
}

/* ------------------------------------------------------------------ */
/* What the "DMA hardware" reports                                     */
/* ------------------------------------------------------------------ */

static atomic_t active_seq;          /* transfer in progress, set by the driver */
static atomic_t done_seq;            /* last transfer completed, set by the ISR */
static atomic_t in_wait;             /* 1 while the driver is inside its wait */
static atomic_t completion_was_early;  /* the ISR ran while the driver was not waiting */
static atomic_t next_is_late;        /* set by the button */
static volatile uint32_t isr_cycles; /* cycle counter just before the signal */

/* ------------------------------------------------------------------ */
/* The four mechanisms. Each provides the same three functions:        */
/*   signal_reset()     discard a leftover signal (before a transfer)  */
/*   signal_from_isr()  the completion ISR signals the driver          */
/*   signal_wait()      the driver waits: 0 with *status, or -EAGAIN   */
/* ------------------------------------------------------------------ */

#if defined(CONFIG_APP_NOTIFY_SEM)

#define MECH_NAME    "k_sem"
#define MECH_SIZE    sizeof(struct k_sem)
#define MECH_CARRIES "nothing (the status goes in a shared variable)"

K_SEM_DEFINE(done_sem, 0, 1);            /* binary: count 0, limit 1 */
static atomic_t dma_status;              /* 0 or -EIO: the semaphore cannot carry it */

static void signal_reset(void)
{
	k_sem_reset(&done_sem);
}

static void signal_from_isr(int status)
{
	atomic_set(&dma_status, status);     /* written before the give */
	k_sem_give(&done_sem);
}

static int signal_wait(k_timeout_t timeout, int *status)
{
	if (k_sem_take(&done_sem, timeout) != 0) {
		return -EAGAIN;
	}
	*status = (int)atomic_get(&dma_status);
	return 0;
}

#elif defined(CONFIG_APP_NOTIFY_EVENT)

#define MECH_NAME    "k_event"
#define MECH_SIZE    sizeof(struct k_event)
#define MECH_CARRIES "up to 32 bits (here DONE or ERROR)"

#define EV_DONE   BIT(0)
#define EV_ERROR  BIT(1)

K_EVENT_DEFINE(done_event);

static void signal_reset(void)
{
	k_event_clear(&done_event, EV_DONE | EV_ERROR);
}

static void signal_from_isr(int status)
{
	k_event_post(&done_event, status == 0 ? EV_DONE : EV_ERROR);
}

static int signal_wait(k_timeout_t timeout, int *status)
{
	uint32_t got = k_event_wait(&done_event, EV_DONE | EV_ERROR, false, timeout);

	if (got == 0) {
		return -EAGAIN;
	}
	k_event_clear(&done_event, got);     /* consume what we got (tutorial 04) */
	*status = (got & EV_ERROR) ? -EIO : 0;
	return 0;
}

#elif defined(CONFIG_APP_NOTIFY_POLL_SIGNAL)

#define MECH_NAME    "k_poll_signal"
#define MECH_SIZE    sizeof(struct k_poll_signal)
#define MECH_CARRIES "one int (here the status itself)"

static struct k_poll_signal done_signal; /* k_poll_signal_init() in demo_start() */

static void signal_reset(void)
{
	k_poll_signal_reset(&done_signal);
}

static void signal_from_isr(int status)
{
	k_poll_signal_raise(&done_signal, status);  /* the status travels with the signal */
}

static int signal_wait(k_timeout_t timeout, int *status)
{
	/* What to wait for. A fresh one each time: its state starts NOT_READY. */
	struct k_poll_event ev = K_POLL_EVENT_INITIALIZER(K_POLL_TYPE_SIGNAL,
							  K_POLL_MODE_NOTIFY_ONLY,
							  &done_signal);
	unsigned int signaled;
	int result;
	unsigned int key;

	if (k_poll(&ev, 1, timeout) != 0) {
		return -EAGAIN;                  /* -EAGAIN on timeout */
	}

	/*
	 * Read the result and reset the signal in one step. Between a
	 * separate check and reset, an ISR could raise again, and the reset
	 * would erase that raise.
	 */
	key = irq_lock();
	k_poll_signal_check(&done_signal, &signaled, &result);
	k_poll_signal_reset(&done_signal);
	irq_unlock(key);

	*status = result;
	return 0;
}

#elif defined(CONFIG_APP_NOTIFY_WAKEUP)

#define MECH_NAME    "k_wakeup"
#define MECH_SIZE    0                   /* uses the thread's own timeout */
#define MECH_CARRIES "nothing (the status goes in a shared variable)"

static atomic_t dma_status;              /* 0 or -EIO: a wakeup cannot carry it */

static void signal_reset(void)
{
	/* Nothing to reset: a wakeup has no memory. */
}

static void signal_from_isr(int status)
{
	atomic_set(&dma_status, status);
	k_wakeup(driver_tid);                /* ends a k_sleep(), if there is one */
}

static int signal_wait(k_timeout_t timeout, int *status)
{
	/*
	 * k_sleep() returns the time left: 0 if it slept to the end, more
	 * if a k_wakeup() ended it early. (A wakeup in the very last tick
	 * also returns 0 and looks like a timeout.)
	 */
	if (k_sleep(timeout) == 0) {
		return -EAGAIN;
	}
	*status = (int)atomic_get(&dma_status);
	return 0;
}

#endif

/* ------------------------------------------------------------------ */
/* The "DMA complete" interrupt                                        */
/* ------------------------------------------------------------------ */

static void dma_complete_isr(struct k_timer *timer)
{
	ARG_UNUSED(timer);

	uint32_t seq = (uint32_t)atomic_get(&active_seq);
	int status = (CONFIG_APP_ERROR_EVERY > 0 && seq % CONFIG_APP_ERROR_EVERY == 0) ? -EIO : 0;

	atomic_set(&completion_was_early, !atomic_get(&in_wait));
	atomic_set(&done_seq, seq);
	isr_cycles = k_cycle_get_32();
	signal_from_isr(status);
}

K_TIMER_DEFINE(dma_timer, dma_complete_isr, NULL);

/* ------------------------------------------------------------------ */
/* The driver                                                          */
/* ------------------------------------------------------------------ */

enum outcome { OUT_OK, OUT_TIMEOUT, OUT_LOST, OUT_STALE };

/* Written only by the driver, read by demo_report() under irq_lock(). */
static uint32_t transfers, ok, errors, timeouts, lost, stale, early, stray;
static uint32_t lat_samples, lat_min = UINT32_MAX, lat_max;
static uint64_t lat_sum;

static void record_latency(uint32_t cycles)
{
	lat_samples++;
	lat_sum += cycles;
	lat_min = MIN(lat_min, cycles);
	lat_max = MAX(lat_max, cycles);
}

static void driver_thread(void *p1, void *p2, void *p3)
{
	enum outcome last = OUT_OK;
	int64_t next = k_uptime_get();
	uint32_t seq = 0;

	ARG_UNUSED(p1);
	ARG_UNUSED(p2);
	ARG_UNUSED(p3);

	while (1) {
		seq++;

		if (IS_ENABLED(CONFIG_APP_RESET_BEFORE_START)) {
			signal_reset();          /* a late completion of an old transfer */
		}

		/* No printk() here: it takes milliseconds and would delay the start. */
		bool late = atomic_clear(&next_is_late);
		int dma_ms = late ? CONFIG_APP_DMA_TIMEOUT_MS + LATE_EXTRA_MS
				  : CONFIG_APP_DMA_TIME_MS;

		/* Start the "transfer". */
		atomic_set(&active_seq, seq);
		k_timer_start(&dma_timer, K_MSEC(dma_ms), K_NO_WAIT);

		if (CONFIG_APP_SETUP_US > 0) {
			k_busy_wait(CONFIG_APP_SETUP_US);   /* experiment A2 */
		}

		/* Wait for the completion. */
		int status = 0;

		atomic_set(&in_wait, 1);
		int ret = signal_wait(K_MSEC(CONFIG_APP_DMA_TIMEOUT_MS), &status);
		uint32_t woke_cycles = k_cycle_get_32();

		atomic_set(&in_wait, 0);

		/* What happened? */
		enum outcome out;

		transfers++;
		if (ret != 0) {
			if ((uint32_t)atomic_get(&done_seq) == seq) {
				out = OUT_LOST;          /* it completed, but we never woke */
				lost++;
			} else {
				out = OUT_TIMEOUT;
				timeouts++;
			}
		} else if ((uint32_t)atomic_get(&done_seq) != seq) {
			out = OUT_STALE;                 /* woken by an older transfer's signal */
			stale++;
		} else {
			out = OUT_OK;
			if (status == 0) {
				ok++;
			} else {
				errors++;
			}
			if (atomic_get(&completion_was_early)) {
				early++;                 /* no wake-up to measure */
			} else {
				record_latency(woke_cycles - isr_cycles);
			}
		}

		/* Print only changes, so a failure that repeats prints once. */
		if (out != last) {
			switch (out) {
			case OUT_TIMEOUT:
				printk("[driver] t=%u ms  transfer %u: no completion within %d ms "
				       "(timeout)%s\n", now_ms(), seq, CONFIG_APP_DMA_TIMEOUT_MS,
				       late ? ", the button made this DMA late" : "");
				break;
			case OUT_LOST:
				printk("[driver] t=%u ms  transfer %u: completed, but the signal "
				       "was lost (timeout)\n", now_ms(), seq);
				break;
			case OUT_STALE:
				printk("[driver] t=%u ms  transfer %u: woke at once, for transfer "
				       "%u's completion (STALE)\n", now_ms(), seq,
				       (uint32_t)atomic_get(&done_seq));
				break;
			case OUT_OK:
				printk("[driver] t=%u ms  transfer %u: normal again\n", now_ms(), seq);
				break;
			}
			last = out;
		}
		event_led_set(out != OUT_OK);        /* red LED: the last transfer went wrong */

		/*
		 * Pause until the next transfer is due. With k_wakeup(), a
		 * completion that arrives now ends this sleep early: the wakeup
		 * cannot tell one k_sleep() from another. Sleep again until the
		 * absolute deadline. For the other mechanisms k_sleep() never
		 * returns early, and the loop runs once.
		 */
		next += CONFIG_APP_TRANSFER_PERIOD_MS;
		while (k_sleep(K_TIMEOUT_ABS_MS(next)) > 0) {
			stray++;
			printk("[driver] t=%u ms  pause cut short by a stray k_wakeup()\n",
			       now_ms());
		}
	}
}

/* ------------------------------------------------------------------ */
/* Called by main.c                                                    */
/* ------------------------------------------------------------------ */

/* The button makes the next transfer complete after its timeout. ISR context. */
void demo_button_pressed(void)
{
	atomic_set(&next_is_late, 1);
}

void demo_start(void)
{
#if defined(CONFIG_APP_NOTIFY_POLL_SIGNAL)
	k_poll_signal_init(&done_signal);
#endif
	k_thread_name_set(driver_tid, "driver");

	printk("Part A: a driver thread and its completion ISR. Signal: %s\n", MECH_NAME);
	printk("  object size: %u bytes   carries: %s\n", (unsigned int)MECH_SIZE, MECH_CARRIES);
	printk("  a transfer every %d ms, DMA %d ms, timeout %d ms, setup %d us, "
	       "error every %d, reset before start: %s\n",
	       CONFIG_APP_TRANSFER_PERIOD_MS, CONFIG_APP_DMA_TIME_MS, CONFIG_APP_DMA_TIMEOUT_MS,
	       CONFIG_APP_SETUP_US, CONFIG_APP_ERROR_EVERY,
	       IS_ENABLED(CONFIG_APP_RESET_BEFORE_START) ? "yes" : "NO");
	printk("  cycle counter: %u Hz\n", (unsigned int)sys_clock_hw_cycles_per_sec());

	t0 = k_uptime_get();
	k_thread_start(driver_tid);
}

void demo_report(void)
{
	uint32_t s_tr, s_ok, s_err, s_to, s_lost, s_stale, s_early, s_stray;
	uint32_t n, mn, mx;
	uint64_t sum;
	unsigned int key;

	/* A consistent snapshot: the driver cannot run between these reads. */
	key = irq_lock();
	s_tr = transfers; s_ok = ok; s_err = errors; s_to = timeouts;
	s_lost = lost; s_stale = stale; s_early = early; s_stray = stray;
	n = lat_samples; mn = lat_min; mx = lat_max; sum = lat_sum;
	irq_unlock(key);

	printk("[driver] t=%u ms  %s: transfers=%u ok=%u errors=%u timeouts=%u lost=%u "
	       "stale=%u early=%u stray=%u\n",
	       now_ms(), MECH_NAME, s_tr, s_ok, s_err, s_to, s_lost, s_stale, s_early, s_stray);

	if (n == 0) {
		printk("[driver]   ISR-to-thread wake-up: no samples\n");
		return;
	}
	printk("[driver]   ISR-to-thread wake-up, %u samples: min=%u avg=%u max=%u ns "
	       "(cycles %u/%u/%u)\n", n,
	       (uint32_t)k_cyc_to_ns_floor64(mn), (uint32_t)k_cyc_to_ns_floor64(sum / n),
	       (uint32_t)k_cyc_to_ns_floor64(mx), mn, (uint32_t)(sum / n), mx);
}
```

## src/signal_bench.c
```c
/*
 * 05_task_notifications, Part B: four receivers, one ISR, the same signals
 *
 * Each receiver thread has its own one-to-one signal, implemented with a
 * different mechanism. A k_timer ISR sends every signal to all four at
 * the same moment, so any difference in what they handle comes from the
 * mechanism alone:
 *
 *   k_sem          counting semaphore: remembers how many
 *   k_event        one bit: remembers that, not how many
 *   k_poll_signal  a flag and an int: remembers that, and the LAST value
 *   k_wakeup()     nothing: works only if the receiver is asleep right then
 *
 * Every round (CONFIG_APP_BENCH_PERIOD_MS) the ISR sends a burst of
 * CONFIG_APP_BENCH_BURST signals back to back, and one more signal
 * CONFIG_APP_BENCH_LATE_MS later, while the receivers are still busy
 * with the first. Each receiver spends CONFIG_APP_BENCH_HANDLE_MS on every
 * wake-up, in k_msleep(). The button sends one extra signal.
 */

#include <zephyr/kernel.h>
#include <zephyr/sys/atomic.h>
#include <zephyr/sys/printk.h>
#include <zephyr/sys/util.h>

#include "demo.h"

enum receiver { RX_SEM, RX_EVENT, RX_POLL, RX_WAKEUP, NUM_RX };

static const char *const rx_label[NUM_RX] = {
	"k_sem     counts    ",
	"k_event   one bit   ",
	"k_poll    last value",
	"k_wakeup  no memory ",
};

#define STACK_SIZE   1024
#define RX_PRIORITY  3
#define EV_SIGNAL    BIT(0)

/* A wait so long that it never times out in this demo. */
#define WAKEUP_WAIT_MS 60000

/* One signal object per receiver: one-to-one. */
K_SEM_DEFINE(rx_sem, 0, K_SEM_MAX_LIMIT);  /* counting */
K_EVENT_DEFINE(rx_event);
static struct k_poll_signal rx_signal;     /* k_poll_signal_init() in demo_start() */

static atomic_t sent;                      /* signals sent to each receiver */
static atomic_t rounds;
static atomic_t handled[NUM_RX];
static atomic_t overwritten;               /* k_poll: values never seen */
static atomic_t cut_short;                 /* k_wakeup: work sleeps ended early */

static int64_t t0;

static uint32_t now_ms(void)
{
	return (uint32_t)(k_uptime_get() - t0);
}

/* Forward declaration: send_to_all() needs this thread's ID for k_wakeup(). */
static void wakeup_rx(void *p1, void *p2, void *p3);
K_THREAD_DEFINE(wakeup_tid, STACK_SIZE, wakeup_rx, NULL, NULL, NULL,
		RX_PRIORITY, 0, SYS_FOREVER_MS);

/* ------------------------------------------------------------------ */
/* The sender: interrupt context                                       */
/* ------------------------------------------------------------------ */

/* One signal to every receiver. The number n numbers the signals. */
static void send_to_all(void)
{
	int n = (int)atomic_inc(&sent) + 1;     /* atomic_inc returns the old value */

	k_sem_give(&rx_sem);                    /* count++ */
	k_event_post(&rx_event, EV_SIGNAL);     /* bit = 1 */
	k_poll_signal_raise(&rx_signal, n);     /* flag = 1, result = n */
	k_wakeup(wakeup_tid);                   /* end its sleep, if it is asleep */
}

static void late_isr(struct k_timer *timer)
{
	ARG_UNUSED(timer);
	send_to_all();
}

K_TIMER_DEFINE(late_timer, late_isr, NULL);

static void round_isr(struct k_timer *timer)
{
	ARG_UNUSED(timer);

	atomic_inc(&rounds);
	for (int i = 0; i < CONFIG_APP_BENCH_BURST; i++) {
		send_to_all();                  /* no receiver runs in between */
	}
	if (CONFIG_APP_BENCH_LATE_MS > 0) {
		k_timer_start(&late_timer, K_MSEC(CONFIG_APP_BENCH_LATE_MS), K_NO_WAIT);
	}
	event_led_toggle();
}

K_TIMER_DEFINE(round_timer, round_isr, NULL);

void demo_button_pressed(void)
{
	send_to_all();
}

/* ------------------------------------------------------------------ */
/* The receivers                                                       */
/* ------------------------------------------------------------------ */

static void work(void)
{
	k_msleep(CONFIG_APP_BENCH_HANDLE_MS);
}

static void sem_rx(void *p1, void *p2, void *p3)
{
	ARG_UNUSED(p1);
	ARG_UNUSED(p2);
	ARG_UNUSED(p3);

	while (1) {
		k_sem_take(&rx_sem, K_FOREVER);         /* count-- */
		atomic_inc(&handled[RX_SEM]);
		work();
	}
}

static void event_rx(void *p1, void *p2, void *p3)
{
	ARG_UNUSED(p1);
	ARG_UNUSED(p2);
	ARG_UNUSED(p3);

	while (1) {
		uint32_t got = k_event_wait(&rx_event, EV_SIGNAL, false, K_FOREVER);

		k_event_clear(&rx_event, got);          /* clear first, then handle */
		atomic_inc(&handled[RX_EVENT]);
		work();
	}
}

static void poll_rx(void *p1, void *p2, void *p3)
{
	int last_seen = 0;

	ARG_UNUSED(p1);
	ARG_UNUSED(p2);
	ARG_UNUSED(p3);

	while (1) {
		struct k_poll_event ev = K_POLL_EVENT_INITIALIZER(K_POLL_TYPE_SIGNAL,
								  K_POLL_MODE_NOTIFY_ONLY,
								  &rx_signal);
		unsigned int signaled;
		int n;
		unsigned int key;

		k_poll(&ev, 1, K_FOREVER);

		key = irq_lock();                       /* read and reset in one step */
		k_poll_signal_check(&rx_signal, &signaled, &n);
		k_poll_signal_reset(&rx_signal);
		irq_unlock(key);

		atomic_inc(&handled[RX_POLL]);
		if (n > last_seen + 1) {
			atomic_add(&overwritten, n - last_seen - 1);
		}
		last_seen = n;
		work();
	}
}

static void wakeup_rx(void *p1, void *p2, void *p3)
{
	ARG_UNUSED(p1);
	ARG_UNUSED(p2);
	ARG_UNUSED(p3);

	while (1) {
		/* Waiting = sleeping. A k_wakeup() ends the sleep early. */
		if (k_msleep(WAKEUP_WAIT_MS) == 0) {
			continue;                       /* slept to the end: no signal */
		}
		atomic_inc(&handled[RX_WAKEUP]);

		/* The work is a sleep too, and a k_wakeup() ends it just the same. */
		if (k_msleep(CONFIG_APP_BENCH_HANDLE_MS) > 0) {
			atomic_inc(&cut_short);
		}
	}
}

K_THREAD_DEFINE(sem_tid, STACK_SIZE, sem_rx, NULL, NULL, NULL,
		RX_PRIORITY, 0, SYS_FOREVER_MS);
K_THREAD_DEFINE(event_tid, STACK_SIZE, event_rx, NULL, NULL, NULL,
		RX_PRIORITY, 0, SYS_FOREVER_MS);
K_THREAD_DEFINE(poll_tid, STACK_SIZE, poll_rx, NULL, NULL, NULL,
		RX_PRIORITY, 0, SYS_FOREVER_MS);

/* ------------------------------------------------------------------ */
/* Called by main.c                                                    */
/* ------------------------------------------------------------------ */

void demo_start(void)
{
	k_poll_signal_init(&rx_signal);

	k_thread_name_set(sem_tid, "rx_sem");
	k_thread_name_set(event_tid, "rx_event");
	k_thread_name_set(poll_tid, "rx_poll");
	k_thread_name_set(wakeup_tid, "rx_wakeup");

	printk("Part B: one ISR signals four receivers, one mechanism each\n");
	printk("  every %d ms: a burst of %d, then 1 more after %d ms (0 = none); "
	       "%d ms of work per wake-up\n",
	       CONFIG_APP_BENCH_PERIOD_MS, CONFIG_APP_BENCH_BURST, CONFIG_APP_BENCH_LATE_MS,
	       CONFIG_APP_BENCH_HANDLE_MS);
	printk("  bytes per object: k_sem %u, k_event %u, k_poll_signal %u "
	       "(+ k_poll_event %u on the waiter's stack), k_wakeup 0\n",
	       (unsigned int)sizeof(struct k_sem), (unsigned int)sizeof(struct k_event),
	       (unsigned int)sizeof(struct k_poll_signal),
	       (unsigned int)sizeof(struct k_poll_event));

	t0 = k_uptime_get();
	k_thread_start(sem_tid);
	k_thread_start(event_tid);
	k_thread_start(poll_tid);
	k_thread_start(wakeup_tid);

	/* First round half a period in, so that a report never cuts a round. */
	k_timer_start(&round_timer, K_MSEC(CONFIG_APP_BENCH_PERIOD_MS / 2),
		      K_MSEC(CONFIG_APP_BENCH_PERIOD_MS));
}

void demo_report(void)
{
	uint32_t s, r, h[NUM_RX], ow, cs;
	unsigned int key;

	/* A consistent snapshot: no ISR or thread can run between these reads. */
	key = irq_lock();
	s = (uint32_t)atomic_get(&sent);
	r = (uint32_t)atomic_get(&rounds);
	for (int i = 0; i < NUM_RX; i++) {
		h[i] = (uint32_t)atomic_get(&handled[i]);
	}
	ow = (uint32_t)atomic_get(&overwritten);
	cs = (uint32_t)atomic_get(&cut_short);
	irq_unlock(key);

	printk("[report] t=%u ms  rounds=%u  signals sent to each receiver=%u\n",
	       now_ms(), r, s);
	for (int i = 0; i < NUM_RX; i++) {
		printk("[report]   %s  handled=%-4u not handled=%-4u", rx_label[i], h[i], s - h[i]);
		if (i == RX_POLL) {
			printk("  values overwritten=%u", ow);
		} else if (i == RX_WAKEUP) {
			printk("  work sleeps cut short=%u", cs);
		}
		printk("\n");
	}
}
```
